/dts-v1/;

/ {
	interrupt-parent = <0x01>;
	#address-cells = <0x02>;
	#size-cells = <0x02>;
	compatible = "h500\0rockchip,rk3568";
	model = "H500";
	bootargs = "earlycon=uart8250,mmio32,0xfe660000 console=ttyFIQ0";

	aliases {
		gpio0 = "/pinctrl/gpio@fdd60000";
		gpio1 = "/pinctrl/gpio@fe740000";
		gpio2 = "/pinctrl/gpio@fe750000";
		gpio3 = "/pinctrl/gpio@fe760000";
		gpio4 = "/pinctrl/gpio@fe770000";
		i2c0 = "/i2c@fdd40000";
		i2c1 = "/i2c@fe5a0000";
		i2c2 = "/i2c@fe5b0000";
		i2c3 = "/i2c@fe5c0000";
		i2c4 = "/i2c@fe5d0000";
		i2c5 = "/i2c@fe5e0000";
		serial0 = "/serial@fdd50000";
		serial1 = "/serial@fe650000";
		serial2 = "/serial@fe660000";
		serial3 = "/serial@fe670000";
		serial4 = "/serial@fe680000";
		serial5 = "/serial@fe690000";
		serial6 = "/serial@fe6a0000";
		serial7 = "/serial@fe6b0000";
		serial8 = "/serial@fe6c0000";
		serial9 = "/serial@fe6d0000";
		spi0 = "/spi@fe610000";
		spi1 = "/spi@fe620000";
		spi2 = "/spi@fe630000";
		spi3 = "/spi@fe640000";
		ethernet0 = "/ethernet@fe2a0000";
		mmc0 = "/mmc@fe310000";
		mmc1 = "/mmc@fe2b0000";
	};

	cpus {
		#address-cells = <0x02>;
		#size-cells = <0x00>;

		cpu@0 {
			device_type = "cpu";
			compatible = "arm,cortex-a55";
			reg = <0x00 0x00>;
			clocks = <0x02 0x00>;
			#cooling-cells = <0x02>;
			enable-method = "psci";
			operating-points-v2 = <0x03>;
			i-cache-size = <0x8000>;
			i-cache-line-size = <0x40>;
			i-cache-sets = <0x80>;
			d-cache-size = <0x8000>;
			d-cache-line-size = <0x40>;
			d-cache-sets = <0x80>;
			next-level-cache = <0x04>;
			cpu-supply = <0x05>;
			phandle = <0x10>;
		};

		cpu@100 {
			device_type = "cpu";
			compatible = "arm,cortex-a55";
			reg = <0x00 0x100>;
			#cooling-cells = <0x02>;
			enable-method = "psci";
			operating-points-v2 = <0x03>;
			i-cache-size = <0x8000>;
			i-cache-line-size = <0x40>;
			i-cache-sets = <0x80>;
			d-cache-size = <0x8000>;
			d-cache-line-size = <0x40>;
			d-cache-sets = <0x80>;
			next-level-cache = <0x04>;
			cpu-supply = <0x05>;
			phandle = <0x11>;
		};

		cpu@200 {
			device_type = "cpu";
			compatible = "arm,cortex-a55";
			reg = <0x00 0x200>;
			#cooling-cells = <0x02>;
			enable-method = "psci";
			operating-points-v2 = <0x03>;
			i-cache-size = <0x8000>;
			i-cache-line-size = <0x40>;
			i-cache-sets = <0x80>;
			d-cache-size = <0x8000>;
			d-cache-line-size = <0x40>;
			d-cache-sets = <0x80>;
			next-level-cache = <0x04>;
			cpu-supply = <0x05>;
			phandle = <0x12>;
		};

		cpu@300 {
			device_type = "cpu";
			compatible = "arm,cortex-a55";
			reg = <0x00 0x300>;
			#cooling-cells = <0x02>;
			enable-method = "psci";
			operating-points-v2 = <0x03>;
			i-cache-size = <0x8000>;
			i-cache-line-size = <0x40>;
			i-cache-sets = <0x80>;
			d-cache-size = <0x8000>;
			d-cache-line-size = <0x40>;
			d-cache-sets = <0x80>;
			next-level-cache = <0x04>;
			cpu-supply = <0x05>;
			phandle = <0x13>;
		};
	};

	l3-cache {
		compatible = "cache";
		cache-level = <0x02>;
		cache-unified;
		cache-size = <0x80000>;
		cache-line-size = <0x40>;
		cache-sets = <0x200>;
		phandle = <0x04>;
	};

	opp-table-0 {
		compatible = "operating-points-v2";
		opp-shared;
		phandle = <0x03>;

		opp-408000000 {
			opp-hz = <0x00 0x18519600>;
			opp-microvolt = <0xcf850 0xcf850 0x118c30>;
			clock-latency-ns = <0x9c40>;
		};

		opp-600000000 {
			opp-hz = <0x00 0x23c34600>;
			opp-microvolt = <0xcf850 0xcf850 0x118c30>;
			clock-latency-ns = <0x9c40>;
		};

		opp-816000000 {
			opp-hz = <0x00 0x30a32c00>;
			opp-microvolt = <0xcf850 0xcf850 0x118c30>;
			opp-suspend;
			clock-latency-ns = <0x9c40>;
		};

		opp-1104000000 {
			opp-hz = <0x00 0x41cdb400>;
			opp-microvolt = <0xdbba0 0xdbba0 0x118c30>;
			clock-latency-ns = <0x9c40>;
		};

		opp-1416000000 {
			opp-hz = <0x00 0x54667200>;
			opp-microvolt = <0xfa3e8 0xfa3e8 0x118c30>;
			clock-latency-ns = <0x9c40>;
		};

		opp-1608000000 {
			opp-hz = <0x00 0x5fd82200>;
			opp-microvolt = <0x10c8e0 0x10c8e0 0x118c30>;
			clock-latency-ns = <0x9c40>;
		};

		opp-1800000000 {
			opp-hz = <0x00 0x6b49d200>;
			opp-microvolt = <0x118c30 0x118c30 0x118c30>;
			clock-latency-ns = <0x9c40>;
		};

		opp-1992000000 {
			opp-hz = <0x00 0x76bb8200>;
			opp-microvolt = <0x118c30 0x118c30 0x118c30>;
			clock-latency-ns = <0x9c40>;
		};
	};

	display-subsystem {
		compatible = "rockchip,display-subsystem";
		ports = <0x06>;
	};

	firmware {

		scmi {
			compatible = "arm,scmi-smc";
			arm,smc-id = <0x82000010>;
			shmem = <0x07>;
			#address-cells = <0x01>;
			#size-cells = <0x00>;

			protocol@14 {
				reg = <0x14>;
				#clock-cells = <0x01>;
				phandle = <0x02>;
			};
		};
	};

	opp-table-1 {
		compatible = "operating-points-v2";
		mbist-vmin = <0xc96a8 0xdbba0 0xe7ef0>;
		nvmem-cells = <0x08 0x09 0x0a 0x0b 0x0c 0x0d>;
		nvmem-cell-names = "leakage\0pvtm\0mbist-vmin\0opp-info\0specification_serial_number\0remark_spec_serial_number";
		rockchip,supported-hw;
		rockchip,max-volt = <0xf4240>;
		rockchip,temp-hysteresis = <0x1388>;
		rockchip,low-temp = <0x00>;
		rockchip,low-temp-adjust-volt = <0x00 0x320 0xc350>;
		rockchip,pvtm-voltage-sel = <0x00 0x14820 0x00 0x14821 0x153d8 0x01 0x153d9 0x16378 0x02 0x16379 0x186a0 0x03>;
		rockchip,pvtm-ch = <0x00 0x05>;
		phandle = <0x4f>;

		opp-200000000 {
			opp-hz = <0x00 0xbebc200>;
			opp-microvolt = <0xcf850 0xcf850 0xf4240>;
			opp-supported-hw = <0xfb 0xffff>;
		};

		opp-300000000 {
			opp-hz = <0x00 0x11e1a300>;
			opp-microvolt = <0xcf850 0xcf850 0xf4240>;
			opp-supported-hw = <0xfb 0xffff>;
		};

		opp-400000000 {
			opp-hz = <0x00 0x17d78400>;
			opp-microvolt = <0xcf850 0xcf850 0xf4240>;
			opp-supported-hw = <0xfb 0xffff>;
		};

		opp-600000000 {
			opp-hz = <0x00 0x23c34600>;
			opp-microvolt = <0xdbba0 0xdbba0 0xf4240>;
			opp-supported-hw = <0xfb 0xffff>;
			opp-microvolt-L0 = <0xdbba0 0xdbba0 0xf4240>;
			opp-microvolt-L1 = <0xd59f8 0xd59f8 0xf4240>;
			opp-microvolt-L2 = <0xcf850 0xcf850 0xf4240>;
			opp-microvolt-L3 = <0xcf850 0xcf850 0xf4240>;
		};

		opp-700000000 {
			opp-hz = <0x00 0x29b92700>;
			opp-microvolt = <0xe7ef0 0xe7ef0 0xf4240>;
			opp-supported-hw = <0xfb 0xffff>;
			opp-microvolt-L0 = <0xe7ef0 0xe7ef0 0xf4240>;
			opp-microvolt-L1 = <0xe1d48 0xe1d48 0xf4240>;
			opp-microvolt-L2 = <0xdbba0 0xdbba0 0xf4240>;
			opp-microvolt-L3 = <0xd59f8 0xd59f8 0xf4240>;
		};

		opp-800000000 {
			opp-hz = <0x00 0x2faf0800>;
			opp-microvolt = <0xf4240 0xf4240 0xf4240>;
			opp-supported-hw = <0xf9 0xffff>;
			opp-microvolt-L0 = <0xf4240 0xf4240 0xf4240>;
			opp-microvolt-L1 = <0xee098 0xee098 0xf4240>;
			opp-microvolt-L2 = <0xe7ef0 0xe7ef0 0xf4240>;
			opp-microvolt-L3 = <0xe1d48 0xe1d48 0xf4240>;
		};
	};

	hdmi-sound {
		compatible = "simple-audio-card";
		simple-audio-card,name = "HDMI";
		simple-audio-card,format = "i2s";
		simple-audio-card,mclk-fs = <0x100>;
		status = "okay";

		simple-audio-card,codec {
			sound-dai = <0x0e>;
		};

		simple-audio-card,cpu {
			sound-dai = <0x0f>;
		};
	};

	pmu {
		compatible = "arm,cortex-a55-pmu";
		interrupts = <0x00 0xe4 0x04 0x00 0xe5 0x04 0x00 0xe6 0x04 0x00 0xe7 0x04>;
		interrupt-affinity = <0x10 0x11 0x12 0x13>;
	};

	psci {
		compatible = "arm,psci-1.0";
		method = "smc";
	};

	reserved-memory {
		#address-cells = <0x02>;
		#size-cells = <0x02>;
		ranges;

		shmem@10f000 {
			compatible = "arm,scmi-shmem";
			reg = <0x00 0x10f000 0x00 0x100>;
			no-map;
			phandle = <0x07>;
		};

		ramoops@110000 {
			compatible = "ramoops";
			reg = <0x00 0x110000 0x00 0xf0000>;
			console-size = <0x80000>;
			ftrace-size = <0x00>;
			pmsg-size = <0x50000>;
			record-size = <0x20000>;
		};

		vpu-cma {
			compatible = "shared-dma-pool";
			reusable;
			size = <0x00 0x10000000>;
			alloc-ranges = <0x00 0x00 0x00 0xffffffff>;
			linux,cma-default;
			phandle = <0xd6>;
		};
	};

	timer {
		compatible = "arm,armv8-timer";
		interrupts = <0x01 0x0d 0x04 0x01 0x0e 0x04 0x01 0x0b 0x04 0x01 0x0a 0x04>;
		arm,no-tick-in-suspend;
	};

	xin24m {
		compatible = "fixed-clock";
		clock-frequency = <0x16e3600>;
		clock-output-names = "xin24m";
		#clock-cells = <0x00>;
		phandle = <0x23>;
	};

	xin32k {
		compatible = "fixed-clock";
		clock-frequency = <0x8000>;
		clock-output-names = "xin32k";
		pinctrl-0 = <0x14>;
		pinctrl-names = "default";
		#clock-cells = <0x00>;
	};

	sata@fc400000 {
		compatible = "rockchip,rk3568-dwc-ahci\0snps,dwc-ahci";
		reg = <0x00 0xfc400000 0x00 0x1000>;
		clocks = <0x15 0x9b 0x15 0x9c 0x15 0x9d>;
		clock-names = "sata\0pmalive\0rxoob";
		interrupts = <0x00 0x5f 0x04>;
		phys = <0x16 0x01>;
		phy-names = "sata-phy";
		ports-implemented = <0x01>;
		power-domains = <0x17 0x0f>;
		status = "disabled";
	};

	sata@fc800000 {
		compatible = "rockchip,rk3568-dwc-ahci\0snps,dwc-ahci";
		reg = <0x00 0xfc800000 0x00 0x1000>;
		clocks = <0x15 0xa0 0x15 0xa1 0x15 0xa2>;
		clock-names = "sata\0pmalive\0rxoob";
		interrupts = <0x00 0x60 0x04>;
		phys = <0x18 0x01>;
		phy-names = "sata-phy";
		ports-implemented = <0x01>;
		power-domains = <0x17 0x0f>;
		status = "disabled";
	};

	usb@fcc00000 {
		compatible = "rockchip,rk3568-dwc3\0snps,dwc3";
		reg = <0x00 0xfcc00000 0x00 0x400000>;
		interrupts = <0x00 0xa9 0x04>;
		clocks = <0x15 0xa6 0x15 0xa7 0x15 0xa5>;
		clock-names = "ref_clk\0suspend_clk\0bus_clk";
		dr_mode = "host";
		phy_type = "utmi_wide";
		power-domains = <0x17 0x0f>;
		resets = <0x15 0x94>;
		snps,dis_u2_susphy_quirk;
		status = "okay";
		phys = <0x19>;
		phy-names = "usb2-phy";
		extcon = <0x1a>;
		maximum-speed = "high-speed";
	};

	usb@fd000000 {
		compatible = "rockchip,rk3568-dwc3\0snps,dwc3";
		reg = <0x00 0xfd000000 0x00 0x400000>;
		interrupts = <0x00 0xaa 0x04>;
		clocks = <0x15 0xa9 0x15 0xaa 0x15 0xa8>;
		clock-names = "ref_clk\0suspend_clk\0bus_clk";
		dr_mode = "host";
		phys = <0x1b 0x16 0x04>;
		phy-names = "usb2-phy\0usb3-phy";
		phy_type = "utmi_wide";
		power-domains = <0x17 0x0f>;
		resets = <0x15 0x95>;
		snps,dis_u2_susphy_quirk;
		status = "okay";
	};

	interrupt-controller@fd400000 {
		compatible = "arm,gic-v3";
		reg = <0x00 0xfd400000 0x00 0x10000 0x00 0xfd460000 0x00 0xc0000>;
		interrupts = <0x01 0x09 0x04>;
		interrupt-controller;
		#interrupt-cells = <0x03>;
		mbi-alias = <0x00 0xfd410000>;
		mbi-ranges = <0x128 0x18>;
		msi-controller;
		ranges;
		#address-cells = <0x02>;
		#size-cells = <0x02>;
		dma-noncoherent;
		phandle = <0x01>;

		msi-controller@fd440000 {
			compatible = "arm,gic-v3-its";
			reg = <0x00 0xfd440000 0x00 0x20000>;
			dma-noncoherent;
			msi-controller;
			#msi-cells = <0x01>;
			status = "okay";
			phandle = <0x61>;
		};
	};

	usb@fd800000 {
		compatible = "generic-ehci";
		reg = <0x00 0xfd800000 0x00 0x40000>;
		interrupts = <0x00 0x82 0x04>;
		clocks = <0x15 0xbd 0x15 0xbe 0x15 0xbc>;
		phys = <0x1c>;
		phy-names = "usb";
		status = "okay";
	};

	usb@fd840000 {
		compatible = "generic-ohci";
		reg = <0x00 0xfd840000 0x00 0x40000>;
		interrupts = <0x00 0x83 0x04>;
		clocks = <0x15 0xbd 0x15 0xbe 0x15 0xbc>;
		phys = <0x1c>;
		phy-names = "usb";
		status = "okay";
	};

	usb@fd880000 {
		compatible = "generic-ehci";
		reg = <0x00 0xfd880000 0x00 0x40000>;
		interrupts = <0x00 0x85 0x04>;
		clocks = <0x15 0xbf 0x15 0xc0 0x15 0xbc>;
		phys = <0x1d>;
		phy-names = "usb";
		status = "okay";
	};

	usb@fd8c0000 {
		compatible = "generic-ohci";
		reg = <0x00 0xfd8c0000 0x00 0x40000>;
		interrupts = <0x00 0x86 0x04>;
		clocks = <0x15 0xbf 0x15 0xc0 0x15 0xbc>;
		phys = <0x1d>;
		phy-names = "usb";
		status = "okay";
	};

	syscon@fda00000 {
		compatible = "rockchip,rk3568-xpcs\0syscon";
		reg = <0x00 0xfda00000 0x00 0x200000>;
		status = "disabled";
	};

	syscon@fdc20000 {
		compatible = "rockchip,rk3568-pmugrf\0syscon\0simple-mfd";
		reg = <0x00 0xfdc20000 0x00 0x10000>;
		phandle = <0x5f>;

		io-domains {
			compatible = "rockchip,rk3568-pmu-io-voltage-domain";
			status = "okay";
			pmuio1-supply = <0x1e>;
			pmuio2-supply = <0x1e>;
			vccio1-supply = <0x1f>;
			vccio2-supply = <0x20>;
			vccio3-supply = <0x21>;
			vccio4-supply = <0x20>;
			vccio5-supply = <0x22>;
			vccio6-supply = <0x20>;
			vccio7-supply = <0x22>;
		};
	};

	syscon@fdc50000 {
		reg = <0x00 0xfdc50000 0x00 0x1000>;
		compatible = "rockchip,rk3568-pipe-grf\0syscon";
		phandle = <0xb0>;
	};

	syscon@fdc60000 {
		compatible = "rockchip,rk3568-grf\0syscon\0simple-mfd";
		reg = <0x00 0xfdc60000 0x00 0x10000>;
		phandle = <0x25>;
	};

	syscon@fdc80000 {
		compatible = "rockchip,rk3568-pipe-phy-grf\0syscon";
		reg = <0x00 0xfdc80000 0x00 0x1000>;
		phandle = <0xb1>;
	};

	syscon@fdc90000 {
		compatible = "rockchip,rk3568-pipe-phy-grf\0syscon";
		reg = <0x00 0xfdc90000 0x00 0x1000>;
		phandle = <0xb2>;
	};

	syscon@fdca0000 {
		compatible = "rockchip,rk3568-usb2phy-grf\0syscon";
		reg = <0x00 0xfdca0000 0x00 0x8000>;
		phandle = <0xb3>;
	};

	syscon@fdca8000 {
		compatible = "rockchip,rk3568-usb2phy-grf\0syscon";
		reg = <0x00 0xfdca8000 0x00 0x8000>;
		phandle = <0xb6>;
	};

	clock-controller@fdd00000 {
		compatible = "rockchip,rk3568-pmucru";
		reg = <0x00 0xfdd00000 0x00 0x1000>;
		#clock-cells = <0x01>;
		#reset-cells = <0x01>;
		phandle = <0x24>;
	};

	clock-controller@fdd20000 {
		compatible = "rockchip,rk3568-cru";
		reg = <0x00 0xfdd20000 0x00 0x1000>;
		clocks = <0x23>;
		clock-names = "xin24m";
		#clock-cells = <0x01>;
		#reset-cells = <0x01>;
		assigned-clocks = <0x24 0x05 0x15 0x04 0x24 0x01>;
		assigned-clock-rates = <0x8000 0x47868c00 0xbebc200>;
		assigned-clock-parents = <0x24 0x08>;
		rockchip,grf = <0x25>;
		phandle = <0x15>;
	};

	i2c@fdd40000 {
		compatible = "rockchip,rk3568-i2c\0rockchip,rk3399-i2c";
		reg = <0x00 0xfdd40000 0x00 0x1000>;
		interrupts = <0x00 0x2e 0x04>;
		clocks = <0x24 0x07 0x24 0x2d>;
		clock-names = "i2c\0pclk";
		pinctrl-0 = <0x26>;
		pinctrl-names = "default";
		#address-cells = <0x01>;
		#size-cells = <0x00>;
		status = "okay";

		regulator@1c {
			compatible = "tcs,tcs4525";
			reg = <0x1c>;
			fcs,suspend-voltage-selector = <0x01>;
			regulator-name = "vdd_cpu";
			regulator-min-microvolt = <0xadf34>;
			regulator-max-microvolt = <0x1535b0>;
			regulator-ramp-delay = <0x8fc>;
			regulator-always-on;
			regulator-boot-on;
			vin-supply = <0x27>;
			phandle = <0x05>;

			regulator-state-mem {
				regulator-off-in-suspend;
			};
		};

		pmic@20 {
			compatible = "rockchip,rk809";
			reg = <0x20>;
			interrupt-parent = <0x28>;
			interrupts = <0x03 0x08>;
			assigned-clocks = <0x15 0x48>;
			assigned-clock-parents = <0x15 0x196>;
			#clock-cells = <0x01>;
			clock-names = "mclk";
			clocks = <0x15 0x48>;
			pinctrl-names = "default\0pmic-sleep\0pmic-reset";
			pinctrl-0 = <0x29>;
			pinctrl-1 = <0x2a 0x2b>;
			clock-output-names = "rk808-clkout1\0rk808-clkout2";
			system-power-controller;
			#sound-dai-cells = <0x00>;
			not-save-power-en = <0x01>;
			vcc1-supply = <0x2c>;
			vcc2-supply = <0x2c>;
			vcc3-supply = <0x2c>;
			vcc4-supply = <0x2c>;
			vcc5-supply = <0x2c>;
			vcc6-supply = <0x2c>;
			vcc7-supply = <0x2c>;
			vcc8-supply = <0x2c>;
			vcc9-supply = <0x2c>;
			wakeup-source;
			phandle = <0xec>;

			pwrkey {
				status = "okay";
			};

			pinctrl_rk8xx {
				gpio-controller;
				#gpio-cells = <0x02>;

				rk817_slppin_null {
					pins = "gpio_slp";
					function = "pin_fun0";
				};

				rk817_slppin_slp {
					pins = "gpio_slp";
					function = "pin_fun1";
					phandle = <0x2b>;
				};

				rk817_slppin_pwrdn {
					pins = "gpio_slp";
					function = "pin_fun2";
				};

				rk817_slppin_rst {
					pins = "gpio_slp";
					function = "pin_fun3";
				};
			};

			regulators {

				DCDC_REG1 {
					regulator-always-on;
					regulator-boot-on;
					regulator-min-microvolt = <0x7a120>;
					regulator-max-microvolt = <0x149970>;
					regulator-init-microvolt = <0xdbba0>;
					regulator-ramp-delay = <0x1771>;
					regulator-initial-mode = <0x02>;
					regulator-name = "vdd_logic";
					phandle = <0xdb>;

					regulator-state-mem {
						regulator-off-in-suspend;
					};
				};

				DCDC_REG2 {
					regulator-always-on;
					regulator-boot-on;
					regulator-min-microvolt = <0x7a120>;
					regulator-max-microvolt = <0x149970>;
					regulator-init-microvolt = <0xdbba0>;
					regulator-ramp-delay = <0x1771>;
					regulator-initial-mode = <0x02>;
					regulator-name = "vdd_gpu";
					phandle = <0x50>;

					regulator-state-mem {
						regulator-off-in-suspend;
					};
				};

				DCDC_REG3 {
					regulator-always-on;
					regulator-boot-on;
					regulator-initial-mode = <0x02>;
					regulator-name = "vcc_ddr";

					regulator-state-mem {
						regulator-on-in-suspend;
					};
				};

				DCDC_REG4 {
					regulator-always-on;
					regulator-boot-on;
					regulator-min-microvolt = <0x7a120>;
					regulator-max-microvolt = <0x149970>;
					regulator-init-microvolt = <0xdbba0>;
					regulator-ramp-delay = <0x1771>;
					regulator-initial-mode = <0x02>;
					regulator-name = "vdd_npu";
					phandle = <0xe1>;

					regulator-state-mem {
						regulator-off-in-suspend;
					};
				};

				LDO_REG1 {
					regulator-boot-on;
					regulator-always-on;
					regulator-min-microvolt = <0xdbba0>;
					regulator-max-microvolt = <0xdbba0>;
					regulator-name = "vdda0v9_image";
					phandle = <0x5b>;

					regulator-state-mem {
						regulator-off-in-suspend;
					};
				};

				LDO_REG2 {
					regulator-always-on;
					regulator-boot-on;
					regulator-min-microvolt = <0xdbba0>;
					regulator-max-microvolt = <0xdbba0>;
					regulator-name = "vdda_0v9";

					regulator-state-mem {
						regulator-off-in-suspend;
					};
				};

				LDO_REG3 {
					regulator-always-on;
					regulator-boot-on;
					regulator-min-microvolt = <0xdbba0>;
					regulator-max-microvolt = <0xdbba0>;
					regulator-name = "vdda0v9_pmu";

					regulator-state-mem {
						regulator-on-in-suspend;
						regulator-suspend-microvolt = <0xdbba0>;
					};
				};

				LDO_REG4 {
					regulator-always-on;
					regulator-boot-on;
					regulator-min-microvolt = <0x325aa0>;
					regulator-max-microvolt = <0x325aa0>;
					regulator-name = "vccio_acodec";
					phandle = <0x1f>;

					regulator-state-mem {
						regulator-off-in-suspend;
					};
				};

				LDO_REG5 {
					regulator-always-on;
					regulator-boot-on;
					regulator-min-microvolt = <0x1b7740>;
					regulator-max-microvolt = <0x325aa0>;
					regulator-name = "vccio_sd";
					phandle = <0x21>;

					regulator-state-mem {
						regulator-off-in-suspend;
					};
				};

				LDO_REG6 {
					regulator-always-on;
					regulator-boot-on;
					regulator-min-microvolt = <0x325aa0>;
					regulator-max-microvolt = <0x325aa0>;
					regulator-name = "vcc3v3_pmu";
					phandle = <0x1e>;

					regulator-state-mem {
						regulator-on-in-suspend;
						regulator-suspend-microvolt = <0x325aa0>;
					};
				};

				LDO_REG7 {
					regulator-always-on;
					regulator-boot-on;
					regulator-min-microvolt = <0x1b7740>;
					regulator-max-microvolt = <0x1b7740>;
					regulator-name = "vcca_1v8";
					phandle = <0xa3>;

					regulator-state-mem {
						regulator-off-in-suspend;
					};
				};

				LDO_REG8 {
					regulator-always-on;
					regulator-boot-on;
					regulator-min-microvolt = <0x1b7740>;
					regulator-max-microvolt = <0x1b7740>;
					regulator-name = "vcca1v8_pmu";

					regulator-state-mem {
						regulator-on-in-suspend;
						regulator-suspend-microvolt = <0x1b7740>;
					};
				};

				LDO_REG9 {
					regulator-always-on;
					regulator-boot-on;
					regulator-min-microvolt = <0x1b7740>;
					regulator-max-microvolt = <0x1b7740>;
					regulator-name = "vcca1v8_image";
					phandle = <0x5c>;

					regulator-state-mem {
						regulator-off-in-suspend;
					};
				};

				DCDC_REG5 {
					regulator-always-on;
					regulator-boot-on;
					regulator-min-microvolt = <0x1b7740>;
					regulator-max-microvolt = <0x1b7740>;
					regulator-name = "vcc_1v8";
					phandle = <0x20>;

					regulator-state-mem {
						regulator-off-in-suspend;
					};
				};

				SWITCH_REG1 {
					regulator-always-on;
					regulator-boot-on;
					regulator-name = "vcc_3v3";
					phandle = <0x22>;

					regulator-state-mem {
						regulator-off-in-suspend;
					};
				};

				SWITCH_REG2 {
					regulator-always-on;
					regulator-boot-on;
					regulator-name = "vcc3v3_sd";

					regulator-state-mem {
						regulator-off-in-suspend;
					};
				};
			};

			codec {
				#sound-dai-cells = <0x00>;
				compatible = "rockchip,rk817-codec";
				clock-names = "mclk";
				assigned-clock-rates = <0xbb8000>;
				pinctrl-names = "default";
				pinctrl-0 = <0x2d>;
				hp-volume = <0x14>;
				spk-volume = <0x03>;
				mic-in-differential;
				status = "okay";
				phandle = <0xf2>;
			};
		};
	};

	serial@fdd50000 {
		compatible = "rockchip,rk3568-uart\0snps,dw-apb-uart";
		reg = <0x00 0xfdd50000 0x00 0x100>;
		interrupts = <0x00 0x74 0x04>;
		clocks = <0x24 0x0b 0x24 0x2c>;
		clock-names = "baudclk\0apb_pclk";
		dmas = <0x2e 0x00 0x2e 0x01>;
		pinctrl-0 = <0x2f>;
		pinctrl-names = "default";
		reg-io-width = <0x04>;
		reg-shift = <0x02>;
		status = "disabled";
	};

	pwm@fdd70000 {
		compatible = "rockchip,rk3568-pwm\0rockchip,rk3328-pwm";
		reg = <0x00 0xfdd70000 0x00 0x10>;
		clocks = <0x24 0x0d 0x24 0x30>;
		clock-names = "pwm\0pclk";
		pinctrl-0 = <0x30>;
		pinctrl-names = "default";
		#pwm-cells = <0x03>;
		status = "okay";
		phandle = <0xf3>;
	};

	pwm@fdd70010 {
		compatible = "rockchip,rk3568-pwm\0rockchip,rk3328-pwm";
		reg = <0x00 0xfdd70010 0x00 0x10>;
		clocks = <0x24 0x0d 0x24 0x30>;
		clock-names = "pwm\0pclk";
		pinctrl-0 = <0x31>;
		pinctrl-names = "default";
		#pwm-cells = <0x03>;
		status = "disabled";
	};

	pwm@fdd70020 {
		compatible = "rockchip,rk3568-pwm\0rockchip,rk3328-pwm";
		reg = <0x00 0xfdd70020 0x00 0x10>;
		clocks = <0x24 0x0d 0x24 0x30>;
		clock-names = "pwm\0pclk";
		pinctrl-0 = <0x32>;
		pinctrl-names = "default";
		#pwm-cells = <0x03>;
		status = "disabled";
	};

	pwm@fdd70030 {
		compatible = "rockchip,rk3568-pwm\0rockchip,rk3328-pwm";
		reg = <0x00 0xfdd70030 0x00 0x10>;
		clocks = <0x24 0x0d 0x24 0x30>;
		clock-names = "pwm\0pclk";
		pinctrl-0 = <0x33>;
		pinctrl-names = "default";
		#pwm-cells = <0x03>;
		status = "okay";
	};

	power-management@fdd90000 {
		compatible = "rockchip,rk3568-pmu\0syscon\0simple-mfd";
		reg = <0x00 0xfdd90000 0x00 0x1000>;

		power-controller {
			compatible = "rockchip,rk3568-power-controller";
			#power-domain-cells = <0x01>;
			#address-cells = <0x01>;
			#size-cells = <0x00>;
			phandle = <0x17>;

			power-domain@7 {
				reg = <0x07>;
				clocks = <0x15 0x19 0x15 0x1a>;
				pm_qos = <0x34>;
				#power-domain-cells = <0x00>;
			};

			power-domain@8 {
				reg = <0x08>;
				clocks = <0x15 0xcc 0x15 0xcd>;
				pm_qos = <0x35 0x36 0x37>;
				#power-domain-cells = <0x00>;
			};

			power-domain@9 {
				reg = <0x09>;
				clocks = <0x15 0xda 0x15 0xdb 0x15 0xdc>;
				pm_qos = <0x38 0x39 0x3a>;
				#power-domain-cells = <0x00>;
			};

			power-domain@10 {
				reg = <0x0a>;
				clocks = <0x15 0xf1 0x15 0xf2>;
				pm_qos = <0x3b 0x3c 0x3d 0x3e 0x3f 0x40>;
				#power-domain-cells = <0x00>;
			};

			power-domain@11 {
				reg = <0x0b>;
				clocks = <0x15 0xed>;
				pm_qos = <0x41>;
				#power-domain-cells = <0x00>;
			};

			power-domain@13 {
				clocks = <0x15 0x107>;
				reg = <0x0d>;
				pm_qos = <0x42>;
				#power-domain-cells = <0x00>;
			};

			power-domain@14 {
				reg = <0x0e>;
				clocks = <0x15 0x102>;
				pm_qos = <0x43 0x44 0x45>;
				#power-domain-cells = <0x00>;
			};

			power-domain@15 {
				reg = <0x0f>;
				clocks = <0x15 0x7f>;
				pm_qos = <0x46 0x47 0x48 0x49 0x4a 0x4b 0x4c 0x4d>;
				#power-domain-cells = <0x00>;
			};

			power-domain@6 {
				reg = <0x06>;
				clocks = <0x15 0x27 0x15 0x25 0x15 0x26>;
				pm_qos = <0x4e>;
				#power-domain-cells = <0x00>;
			};
		};
	};

	gpu@fde60000 {
		compatible = "arm,mali-bifrost";
		reg = <0x00 0xfde60000 0x00 0x4000>;
		interrupts = <0x00 0x27 0x04 0x00 0x29 0x04 0x00 0x28 0x04>;
		interrupt-names = "gpu\0mmu\0job";
		clocks = <0x02 0x01 0x15 0x1b>;
		clock-names = "gpu\0bus";
		#cooling-cells = <0x02>;
		power-domains = <0x17 0x07>;
		status = "okay";
		operating-points-v2 = <0x4f>;
		upthreshold = <0x28>;
		downdifferential = <0x0a>;
		mali-supply = <0x50>;
		phandle = <0xa0>;

		power-model {
			compatible = "simple-power-model";
			leakage-range = <0x05 0x0f>;
			ls = <0xffffa23e 0x5927 0x00>;
			static-coefficient = <0x186a0>;
			dynamic-coefficient = <0x3b9>;
			ts = <0xfffe56a6 0xf87a 0xfffffab5 0x14>;
			thermal-zone = "gpu-thermal";
		};
	};

	iommu@fdea0800 {
		compatible = "rockchip,rk3568-iommu\0rockchip,iommu-v2";
		reg = <0x00 0xfdea0800 0x00 0x40>;
		interrupts = <0x00 0x8a 0x04>;
		clock-names = "aclk\0iface";
		clocks = <0x15 0xee 0x15 0xef>;
		power-domains = <0x17 0x0b>;
		#iommu-cells = <0x00>;
		interrupt-names = "vdpu_mmu";
		status = "okay";
		phandle = <0xd4>;
	};

	iommu@fdee0800 {
		compatible = "rockchip,rk3568-iommu\0rockchip,iommu-v2";
		reg = <0x00 0xfdee0800 0x00 0x40>;
		interrupts = <0x00 0x3f 0x04>;
		clocks = <0x15 0xfd 0x15 0xfe>;
		clock-names = "aclk\0iface";
		power-domains = <0x17 0x0a>;
		#iommu-cells = <0x00>;
		interrupt-names = "vepu_mmu";
		status = "okay";
		phandle = <0xd8>;
	};

	mmc@fe000000 {
		compatible = "rockchip,rk3568-dw-mshc\0rockchip,rk3288-dw-mshc";
		reg = <0x00 0xfe000000 0x00 0x4000>;
		interrupts = <0x00 0x64 0x04>;
		clocks = <0x15 0xc1 0x15 0xc2 0x15 0x18e 0x15 0x18f>;
		clock-names = "biu\0ciu\0ciu-drive\0ciu-sample";
		fifo-depth = <0x100>;
		max-frequency = <0x8f0d180>;
		resets = <0x15 0xeb>;
		reset-names = "reset";
		status = "disabled";
	};

	ethernet@fe010000 {
		compatible = "rockchip,rk3568-gmac\0snps,dwmac-4.20a";
		reg = <0x00 0xfe010000 0x00 0x10000>;
		interrupts = <0x00 0x20 0x04 0x00 0x1d 0x04>;
		interrupt-names = "macirq\0eth_wake_irq";
		clocks = <0x15 0x186 0x15 0x189 0x15 0x189 0x15 0xc7 0x15 0xc3 0x15 0xc4 0x15 0x189 0x15 0xc8>;
		clock-names = "stmmaceth\0mac_clk_rx\0mac_clk_tx\0clk_mac_refout\0aclk_mac\0pclk_mac\0clk_mac_speed\0ptp_ref";
		resets = <0x15 0xec>;
		reset-names = "stmmaceth";
		rockchip,grf = <0x25>;
		snps,axi-config = <0x51>;
		snps,mixed-burst;
		snps,mtl-rx-config = <0x52>;
		snps,mtl-tx-config = <0x53>;
		snps,tso;
		status = "disabled";

		mdio {
			compatible = "snps,dwmac-mdio";
			#address-cells = <0x01>;
			#size-cells = <0x00>;
		};

		stmmac-axi-config {
			snps,blen = <0x00 0x00 0x00 0x00 0x10 0x08 0x04>;
			snps,rd_osr_lmt = <0x08>;
			snps,wr_osr_lmt = <0x04>;
			phandle = <0x51>;
		};

		rx-queues-config {
			snps,rx-queues-to-use = <0x01>;
			phandle = <0x52>;

			queue0 {
			};
		};

		tx-queues-config {
			snps,tx-queues-to-use = <0x01>;
			phandle = <0x53>;

			queue0 {
			};
		};
	};

	vop@fe040000 {
		reg = <0x00 0xfe040000 0x00 0x3000 0x00 0xfe044000 0x00 0x1000>;
		reg-names = "vop\0gamma-lut";
		interrupts = <0x00 0x94 0x04>;
		clocks = <0x15 0xdd 0x15 0xde 0x15 0xdf 0x15 0xe0 0x15 0xe1>;
		clock-names = "aclk\0hclk\0dclk_vp0\0dclk_vp1\0dclk_vp2";
		iommus = <0x54>;
		power-domains = <0x17 0x09>;
		rockchip,grf = <0x25>;
		status = "okay";
		compatible = "rockchip,rk3568-vop";
		assigned-clocks = <0x15 0xdf 0x15 0xe0>;
		assigned-clock-parents = <0x24 0x02 0x15 0x05>;

		ports {
			#address-cells = <0x01>;
			#size-cells = <0x00>;
			phandle = <0x06>;

			port@0 {
				reg = <0x00>;
				#address-cells = <0x01>;
				#size-cells = <0x00>;

				endpoint@2 {
					reg = <0x02>;
					remote-endpoint = <0x55>;
					phandle = <0x5d>;
				};
			};

			port@1 {
				reg = <0x01>;
				#address-cells = <0x01>;
				#size-cells = <0x00>;
			};

			port@2 {
				reg = <0x02>;
				#address-cells = <0x01>;
				#size-cells = <0x00>;
			};
		};
	};

	iommu@fe043e00 {
		compatible = "rockchip,rk3568-iommu";
		reg = <0x00 0xfe043e00 0x00 0x100 0x00 0xfe043f00 0x00 0x100>;
		interrupts = <0x00 0x94 0x04>;
		clocks = <0x15 0xdd 0x15 0xde>;
		clock-names = "aclk\0iface";
		#iommu-cells = <0x00>;
		power-domains = <0x17 0x09>;
		status = "okay";
		phandle = <0x54>;
	};

	dsi@fe060000 {
		compatible = "rockchip,rk3568-mipi-dsi\0snps,dw-mipi-dsi";
		reg = <0x00 0xfe060000 0x00 0x10000>;
		interrupts = <0x00 0x44 0x04>;
		clock-names = "pclk";
		clocks = <0x15 0xe8>;
		phy-names = "dphy";
		phys = <0x56>;
		power-domains = <0x17 0x09>;
		reset-names = "apb";
		resets = <0x15 0x110>;
		rockchip,grf = <0x25>;
		status = "disabled";

		ports {
			#address-cells = <0x01>;
			#size-cells = <0x00>;

			port@0 {
				reg = <0x00>;
			};

			port@1 {
				reg = <0x01>;
			};
		};
	};

	dsi@fe070000 {
		compatible = "rockchip,rk3568-mipi-dsi\0snps,dw-mipi-dsi";
		reg = <0x00 0xfe070000 0x00 0x10000>;
		interrupts = <0x00 0x45 0x04>;
		clock-names = "pclk";
		clocks = <0x15 0xe9>;
		phy-names = "dphy";
		phys = <0x57>;
		power-domains = <0x17 0x09>;
		reset-names = "apb";
		resets = <0x15 0x111>;
		rockchip,grf = <0x25>;
		status = "disabled";

		ports {
			#address-cells = <0x01>;
			#size-cells = <0x00>;

			port@0 {
				reg = <0x00>;
			};

			port@1 {
				reg = <0x01>;
			};
		};
	};

	hdmi@fe0a0000 {
		compatible = "rockchip,rk3568-dw-hdmi";
		reg = <0x00 0xfe0a0000 0x00 0x20000>;
		interrupts = <0x00 0x2d 0x04>;
		clocks = <0x15 0xe6 0x15 0xe7 0x15 0x193 0x24 0x28 0x15 0xda>;
		clock-names = "iahb\0isfr\0cec\0ref";
		pinctrl-names = "default";
		pinctrl-0 = <0x58 0x59 0x5a>;
		power-domains = <0x17 0x09>;
		reg-io-width = <0x04>;
		rockchip,grf = <0x25>;
		#sound-dai-cells = <0x00>;
		status = "okay";
		avdd-0v9-supply = <0x5b>;
		avdd-1v8-supply = <0x5c>;
		phandle = <0x0e>;

		ports {
			#address-cells = <0x01>;
			#size-cells = <0x00>;

			port@0 {
				reg = <0x00>;

				endpoint {
					remote-endpoint = <0x5d>;
					phandle = <0x55>;
				};
			};

			port@1 {
				reg = <0x01>;

				endpoint {
					remote-endpoint = <0x5e>;
					phandle = <0xe5>;
				};
			};
		};
	};

	qos@fe128000 {
		compatible = "rockchip,rk3568-qos\0syscon";
		reg = <0x00 0xfe128000 0x00 0x20>;
		phandle = <0x34>;
	};

	qos@fe138080 {
		compatible = "rockchip,rk3568-qos\0syscon";
		reg = <0x00 0xfe138080 0x00 0x20>;
		phandle = <0x43>;
	};

	qos@fe138100 {
		compatible = "rockchip,rk3568-qos\0syscon";
		reg = <0x00 0xfe138100 0x00 0x20>;
		phandle = <0x44>;
	};

	qos@fe138180 {
		compatible = "rockchip,rk3568-qos\0syscon";
		reg = <0x00 0xfe138180 0x00 0x20>;
		phandle = <0x45>;
	};

	qos@fe148000 {
		compatible = "rockchip,rk3568-qos\0syscon";
		reg = <0x00 0xfe148000 0x00 0x20>;
		phandle = <0x35>;
	};

	qos@fe148080 {
		compatible = "rockchip,rk3568-qos\0syscon";
		reg = <0x00 0xfe148080 0x00 0x20>;
		phandle = <0x36>;
	};

	qos@fe148100 {
		compatible = "rockchip,rk3568-qos\0syscon";
		reg = <0x00 0xfe148100 0x00 0x20>;
		phandle = <0x37>;
	};

	qos@fe150000 {
		compatible = "rockchip,rk3568-qos\0syscon";
		reg = <0x00 0xfe150000 0x00 0x20>;
		phandle = <0x41>;
	};

	qos@fe158000 {
		compatible = "rockchip,rk3568-qos\0syscon";
		reg = <0x00 0xfe158000 0x00 0x20>;
		phandle = <0x3b>;
	};

	qos@fe158100 {
		compatible = "rockchip,rk3568-qos\0syscon";
		reg = <0x00 0xfe158100 0x00 0x20>;
		phandle = <0x3c>;
	};

	qos@fe158180 {
		compatible = "rockchip,rk3568-qos\0syscon";
		reg = <0x00 0xfe158180 0x00 0x20>;
		phandle = <0x3d>;
	};

	qos@fe158200 {
		compatible = "rockchip,rk3568-qos\0syscon";
		reg = <0x00 0xfe158200 0x00 0x20>;
		phandle = <0x3e>;
	};

	qos@fe158280 {
		compatible = "rockchip,rk3568-qos\0syscon";
		reg = <0x00 0xfe158280 0x00 0x20>;
		phandle = <0x3f>;
	};

	qos@fe158300 {
		compatible = "rockchip,rk3568-qos\0syscon";
		reg = <0x00 0xfe158300 0x00 0x20>;
		phandle = <0x40>;
	};

	qos@fe180000 {
		compatible = "rockchip,rk3568-qos\0syscon";
		reg = <0x00 0xfe180000 0x00 0x20>;
		phandle = <0x4e>;
	};

	qos@fe190000 {
		compatible = "rockchip,rk3568-qos\0syscon";
		reg = <0x00 0xfe190000 0x00 0x20>;
		phandle = <0x46>;
	};

	qos@fe190280 {
		compatible = "rockchip,rk3568-qos\0syscon";
		reg = <0x00 0xfe190280 0x00 0x20>;
		phandle = <0x4a>;
	};

	qos@fe190300 {
		compatible = "rockchip,rk3568-qos\0syscon";
		reg = <0x00 0xfe190300 0x00 0x20>;
		phandle = <0x4b>;
	};

	qos@fe190380 {
		compatible = "rockchip,rk3568-qos\0syscon";
		reg = <0x00 0xfe190380 0x00 0x20>;
		phandle = <0x4c>;
	};

	qos@fe190400 {
		compatible = "rockchip,rk3568-qos\0syscon";
		reg = <0x00 0xfe190400 0x00 0x20>;
		phandle = <0x4d>;
	};

	qos@fe198000 {
		compatible = "rockchip,rk3568-qos\0syscon";
		reg = <0x00 0xfe198000 0x00 0x20>;
		phandle = <0x42>;
	};

	qos@fe1a8000 {
		compatible = "rockchip,rk3568-qos\0syscon";
		reg = <0x00 0xfe1a8000 0x00 0x20>;
		phandle = <0x38>;
	};

	qos@fe1a8080 {
		compatible = "rockchip,rk3568-qos\0syscon";
		reg = <0x00 0xfe1a8080 0x00 0x20>;
		phandle = <0x39>;
	};

	qos@fe1a8100 {
		compatible = "rockchip,rk3568-qos\0syscon";
		reg = <0x00 0xfe1a8100 0x00 0x20>;
		phandle = <0x3a>;
	};

	dfi@fe230000 {
		compatible = "rockchip,rk3568-dfi";
		reg = <0x00 0xfe230000 0x00 0x400>;
		interrupts = <0x00 0x0b 0x04>;
		rockchip,pmu = <0x5f>;
		status = "okay";
	};

	pcie@fe260000 {
		compatible = "rockchip,rk3568-pcie";
		reg = <0x03 0xc0000000 0x00 0x400000 0x00 0xfe260000 0x00 0x10000 0x00 0xf4000000 0x00 0x100000>;
		reg-names = "dbi\0apb\0config";
		interrupts = <0x00 0x4b 0x04 0x00 0x4a 0x04 0x00 0x49 0x04 0x00 0x48 0x04 0x00 0x47 0x04>;
		interrupt-names = "sys\0pmc\0msg\0legacy\0err";
		bus-range = <0x00 0x0f>;
		clocks = <0x15 0x81 0x15 0x82 0x15 0x83 0x15 0x84 0x15 0x85>;
		clock-names = "aclk_mst\0aclk_slv\0aclk_dbi\0pclk\0aux";
		device_type = "pci";
		#interrupt-cells = <0x01>;
		interrupt-map-mask = <0x00 0x00 0x00 0x07>;
		interrupt-map = <0x00 0x00 0x00 0x01 0x60 0x00 0x00 0x00 0x00 0x02 0x60 0x01 0x00 0x00 0x00 0x03 0x60 0x02 0x00 0x00 0x00 0x04 0x60 0x03>;
		linux,pci-domain = <0x00>;
		num-ib-windows = <0x06>;
		num-ob-windows = <0x02>;
		max-link-speed = <0x02>;
		msi-map = <0x00 0x61 0x00 0x1000>;
		num-lanes = <0x01>;
		phys = <0x18 0x02>;
		phy-names = "pcie-phy";
		power-domains = <0x17 0x0f>;
		ranges = <0x1000000 0x00 0xf4100000 0x00 0xf4100000 0x00 0x100000 0x2000000 0x00 0xf4200000 0x00 0xf4200000 0x00 0x1e00000 0x3000000 0x00 0x40000000 0x03 0x00 0x00 0x40000000>;
		resets = <0x15 0xa1>;
		reset-names = "pipe";
		#address-cells = <0x03>;
		#size-cells = <0x02>;
		status = "okay";
		num-viewport = <0x04>;
		pinctrl-0 = <0x62>;
		reset-deassert-ms = <0x1388>;
		reset-gpios = <0x63 0x0e 0x00>;
		vpcie3v3-supply = <0x2c>;

		legacy-interrupt-controller {
			#address-cells = <0x00>;
			#interrupt-cells = <0x01>;
			interrupt-controller;
			interrupt-parent = <0x01>;
			interrupts = <0x00 0x48 0x01>;
			phandle = <0x60>;
		};
	};

	mmc@fe2b0000 {
		compatible = "rockchip,rk3568-dw-mshc\0rockchip,rk3288-dw-mshc";
		reg = <0x00 0xfe2b0000 0x00 0x4000>;
		interrupts = <0x00 0x62 0x04>;
		clocks = <0x15 0xb0 0x15 0xb1 0x15 0x18a 0x15 0x18b>;
		clock-names = "biu\0ciu\0ciu-drive\0ciu-sample";
		fifo-depth = <0x100>;
		max-frequency = <0x8f0d180>;
		resets = <0x15 0xd4>;
		reset-names = "reset";
		status = "disabled";
	};

	mmc@fe2c0000 {
		compatible = "rockchip,rk3568-dw-mshc\0rockchip,rk3288-dw-mshc";
		reg = <0x00 0xfe2c0000 0x00 0x4000>;
		interrupts = <0x00 0x63 0x04>;
		clocks = <0x15 0xb2 0x15 0xb3 0x15 0x18c 0x15 0x18d>;
		clock-names = "biu\0ciu\0ciu-drive\0ciu-sample";
		fifo-depth = <0x100>;
		max-frequency = <0x8f0d180>;
		resets = <0x15 0xd6>;
		reset-names = "reset";
		status = "disabled";
	};

	spi@fe300000 {
		compatible = "rockchip,sfc";
		reg = <0x00 0xfe300000 0x00 0x4000>;
		interrupts = <0x00 0x65 0x04>;
		clocks = <0x15 0x78 0x15 0x76>;
		clock-names = "clk_sfc\0hclk_sfc";
		pinctrl-0 = <0x64>;
		pinctrl-names = "default";
		status = "okay";
	};

	mmc@fe310000 {
		compatible = "rockchip,rk3568-dwcmshc";
		reg = <0x00 0xfe310000 0x00 0x10000>;
		interrupts = <0x00 0x13 0x04>;
		assigned-clocks = <0x15 0x7b 0x15 0x7d>;
		assigned-clock-rates = <0xbebc200 0x16e3600>;
		clocks = <0x15 0x7c 0x15 0x7a 0x15 0x79 0x15 0x7b 0x15 0x7d>;
		clock-names = "core\0bus\0axi\0block\0timer";
		status = "okay";
		bus-width = <0x08>;
		supports-emmc;
		non-removable;
		max-frequency = <0xbebc200>;
		pinctrl-names = "default";
		pinctrl-0 = <0x65 0x66 0x67 0x68>;
	};

	rng@fe388000 {
		compatible = "rockchip,cryptov2-rng\0rockchip,rk3568-rng";
		reg = <0x00 0xfe388000 0x00 0x2000>;
		clocks = <0x15 0x70 0x15 0x6f>;
		clock-names = "clk_trng\0hclk_trng";
		resets = <0x15 0x6d>;
		status = "okay";
		reset-names = "reset";
	};

	i2s@fe400000 {
		compatible = "rockchip,rk3568-i2s-tdm";
		reg = <0x00 0xfe400000 0x00 0x1000>;
		interrupts = <0x00 0x34 0x04>;
		assigned-clocks = <0x15 0x3d 0x15 0x41>;
		assigned-clock-rates = <0x46cf7100 0x46cf7100>;
		clocks = <0x15 0x3f 0x15 0x43 0x15 0x39>;
		clock-names = "mclk_tx\0mclk_rx\0hclk";
		dmas = <0x69 0x00>;
		dma-names = "tx";
		resets = <0x15 0x50 0x15 0x51>;
		reset-names = "tx-m\0rx-m";
		rockchip,grf = <0x25>;
		#sound-dai-cells = <0x00>;
		status = "okay";
		phandle = <0x0f>;
	};

	i2s@fe410000 {
		compatible = "rockchip,rk3568-i2s-tdm";
		reg = <0x00 0xfe410000 0x00 0x1000>;
		interrupts = <0x00 0x35 0x04>;
		assigned-clocks = <0x15 0x45 0x15 0x49>;
		assigned-clock-rates = <0x46cf7100 0x46cf7100>;
		clocks = <0x15 0x47 0x15 0x4b 0x15 0x3a>;
		clock-names = "mclk_tx\0mclk_rx\0hclk";
		dmas = <0x69 0x03 0x69 0x02>;
		dma-names = "rx\0tx";
		resets = <0x15 0x52 0x15 0x53>;
		reset-names = "tx-m\0rx-m";
		rockchip,grf = <0x25>;
		pinctrl-names = "default";
		pinctrl-0 = <0x6a 0x6b 0x6c 0x6d 0x6e 0x6f 0x70 0x71 0x72 0x73 0x74 0x75>;
		#sound-dai-cells = <0x00>;
		status = "okay";
		rockchip,trcm-sync-tx-only;
		phandle = <0xf1>;
	};

	i2s@fe420000 {
		compatible = "rockchip,rk3568-i2s-tdm";
		reg = <0x00 0xfe420000 0x00 0x1000>;
		interrupts = <0x00 0x36 0x04>;
		assigned-clocks = <0x15 0x4d>;
		assigned-clock-rates = <0x46cf7100>;
		clocks = <0x15 0x4f 0x15 0x4f 0x15 0x3b>;
		clock-names = "mclk_tx\0mclk_rx\0hclk";
		dmas = <0x69 0x04 0x69 0x05>;
		dma-names = "tx\0rx";
		resets = <0x15 0x54>;
		reset-names = "tx-m";
		rockchip,grf = <0x25>;
		pinctrl-names = "default";
		pinctrl-0 = <0x76 0x77 0x78 0x79>;
		#sound-dai-cells = <0x00>;
		status = "disabled";
	};

	i2s@fe430000 {
		compatible = "rockchip,rk3568-i2s-tdm";
		reg = <0x00 0xfe430000 0x00 0x1000>;
		interrupts = <0x00 0x37 0x04>;
		clocks = <0x15 0x53 0x15 0x57 0x15 0x3c>;
		clock-names = "mclk_tx\0mclk_rx\0hclk";
		dmas = <0x69 0x06 0x69 0x07>;
		dma-names = "tx\0rx";
		resets = <0x15 0x55 0x15 0x56>;
		reset-names = "tx-m\0rx-m";
		rockchip,grf = <0x25>;
		#sound-dai-cells = <0x00>;
		status = "disabled";
	};

	pdm@fe440000 {
		compatible = "rockchip,rk3568-pdm";
		reg = <0x00 0xfe440000 0x00 0x1000>;
		interrupts = <0x00 0x4c 0x04>;
		clocks = <0x15 0x5a 0x15 0x59>;
		clock-names = "pdm_clk\0pdm_hclk";
		dmas = <0x69 0x09>;
		dma-names = "rx";
		pinctrl-0 = <0x7a 0x7b 0x7c 0x7d 0x7e 0x7f>;
		pinctrl-names = "default";
		resets = <0x15 0x58>;
		reset-names = "pdm-m";
		#sound-dai-cells = <0x00>;
		status = "disabled";
	};

	spdif@fe460000 {
		compatible = "rockchip,rk3568-spdif";
		reg = <0x00 0xfe460000 0x00 0x1000>;
		interrupts = <0x00 0x66 0x04>;
		clock-names = "mclk\0hclk";
		clocks = <0x15 0x5f 0x15 0x5c>;
		dmas = <0x69 0x01>;
		dma-names = "tx";
		pinctrl-names = "default";
		pinctrl-0 = <0x80>;
		#sound-dai-cells = <0x00>;
		status = "disabled";
	};

	dma-controller@fe530000 {
		compatible = "arm,pl330\0arm,primecell";
		reg = <0x00 0xfe530000 0x00 0x4000>;
		interrupts = <0x00 0x0e 0x04 0x00 0x0d 0x04>;
		arm,pl330-periph-burst;
		clocks = <0x15 0x10d>;
		clock-names = "apb_pclk";
		#dma-cells = <0x01>;
		phandle = <0x2e>;
	};

	dma-controller@fe550000 {
		compatible = "arm,pl330\0arm,primecell";
		reg = <0x00 0xfe550000 0x00 0x4000>;
		interrupts = <0x00 0x10 0x04 0x00 0x0f 0x04>;
		arm,pl330-periph-burst;
		clocks = <0x15 0x10d>;
		clock-names = "apb_pclk";
		#dma-cells = <0x01>;
		phandle = <0x69>;
	};

	i2c@fe5a0000 {
		compatible = "rockchip,rk3568-i2c\0rockchip,rk3399-i2c";
		reg = <0x00 0xfe5a0000 0x00 0x1000>;
		interrupts = <0x00 0x2f 0x04>;
		clocks = <0x15 0x148 0x15 0x147>;
		clock-names = "i2c\0pclk";
		pinctrl-0 = <0x81>;
		pinctrl-names = "default";
		#address-cells = <0x01>;
		#size-cells = <0x00>;
		status = "disabled";
	};

	i2c@fe5b0000 {
		compatible = "rockchip,rk3568-i2c\0rockchip,rk3399-i2c";
		reg = <0x00 0xfe5b0000 0x00 0x1000>;
		interrupts = <0x00 0x30 0x04>;
		clocks = <0x15 0x14a 0x15 0x149>;
		clock-names = "i2c\0pclk";
		pinctrl-0 = <0x82>;
		pinctrl-names = "default";
		#address-cells = <0x01>;
		#size-cells = <0x00>;
		status = "disabled";
	};

	i2c@fe5c0000 {
		compatible = "rockchip,rk3568-i2c\0rockchip,rk3399-i2c";
		reg = <0x00 0xfe5c0000 0x00 0x1000>;
		interrupts = <0x00 0x31 0x04>;
		clocks = <0x15 0x14c 0x15 0x14b>;
		clock-names = "i2c\0pclk";
		pinctrl-0 = <0x83>;
		pinctrl-names = "default";
		#address-cells = <0x01>;
		#size-cells = <0x00>;
		status = "okay";
	};

	i2c@fe5d0000 {
		compatible = "rockchip,rk3568-i2c\0rockchip,rk3399-i2c";
		reg = <0x00 0xfe5d0000 0x00 0x1000>;
		interrupts = <0x00 0x32 0x04>;
		clocks = <0x15 0x14e 0x15 0x14d>;
		clock-names = "i2c\0pclk";
		pinctrl-0 = <0x84>;
		pinctrl-names = "default";
		#address-cells = <0x01>;
		#size-cells = <0x00>;
		status = "disabled";
	};

	i2c@fe5e0000 {
		compatible = "rockchip,rk3568-i2c\0rockchip,rk3399-i2c";
		reg = <0x00 0xfe5e0000 0x00 0x1000>;
		interrupts = <0x00 0x33 0x04>;
		clocks = <0x15 0x150 0x15 0x14f>;
		clock-names = "i2c\0pclk";
		pinctrl-0 = <0x85>;
		pinctrl-names = "default";
		#address-cells = <0x01>;
		#size-cells = <0x00>;
		status = "okay";

		rtc@51 {
			status = "okay";
			compatible = "nxp,pcf8563";
			reg = <0x51>;
			#clock-cells = <0x00>;
		};
	};

	watchdog@fe600000 {
		compatible = "rockchip,rk3568-wdt\0snps,dw-wdt";
		reg = <0x00 0xfe600000 0x00 0x100>;
		interrupts = <0x00 0x95 0x04>;
		clocks = <0x15 0x116 0x15 0x115>;
		clock-names = "tclk\0pclk";
	};

	spi@fe610000 {
		compatible = "rockchip,rk3568-spi\0rockchip,rk3066-spi";
		reg = <0x00 0xfe610000 0x00 0x1000>;
		interrupts = <0x00 0x67 0x04>;
		clocks = <0x15 0x152 0x15 0x151>;
		clock-names = "spiclk\0apb_pclk";
		dmas = <0x2e 0x14 0x2e 0x15>;
		dma-names = "tx\0rx";
		pinctrl-names = "default";
		pinctrl-0 = <0x86 0x87 0x88>;
		#address-cells = <0x01>;
		#size-cells = <0x00>;
		status = "disabled";
	};

	spi@fe620000 {
		compatible = "rockchip,rk3568-spi\0rockchip,rk3066-spi";
		reg = <0x00 0xfe620000 0x00 0x1000>;
		interrupts = <0x00 0x68 0x04>;
		clocks = <0x15 0x154 0x15 0x153>;
		clock-names = "spiclk\0apb_pclk";
		dmas = <0x2e 0x16 0x2e 0x17>;
		dma-names = "tx\0rx";
		pinctrl-names = "default";
		pinctrl-0 = <0x03 0x11 0x03 0x89>;
		#address-cells = <0x01>;
		#size-cells = <0x00>;
		status = "okay";

		spi_dev@0 {
			compatible = "rockchip,spidev";
			reg = <0x00>;
			spi-max-frequency = <0xb71b00>;
		};
	};

	spi@fe630000 {
		compatible = "rockchip,rk3568-spi\0rockchip,rk3066-spi";
		reg = <0x00 0xfe630000 0x00 0x1000>;
		interrupts = <0x00 0x69 0x04>;
		clocks = <0x15 0x156 0x15 0x155>;
		clock-names = "spiclk\0apb_pclk";
		dmas = <0x2e 0x18 0x2e 0x19>;
		dma-names = "tx\0rx";
		pinctrl-names = "default";
		pinctrl-0 = <0x8a 0x8b 0x8c>;
		#address-cells = <0x01>;
		#size-cells = <0x00>;
		status = "disabled";
	};

	spi@fe640000 {
		compatible = "rockchip,rk3568-spi\0rockchip,rk3066-spi";
		reg = <0x00 0xfe640000 0x00 0x1000>;
		interrupts = <0x00 0x6a 0x04>;
		clocks = <0x15 0x158 0x15 0x157>;
		clock-names = "spiclk\0apb_pclk";
		dmas = <0x2e 0x1a 0x2e 0x1b>;
		dma-names = "tx\0rx";
		pinctrl-names = "default";
		pinctrl-0 = <0x8d 0x8e 0x8f>;
		#address-cells = <0x01>;
		#size-cells = <0x00>;
		status = "disabled";
	};

	serial@fe650000 {
		compatible = "rockchip,rk3568-uart\0snps,dw-apb-uart";
		reg = <0x00 0xfe650000 0x00 0x100>;
		interrupts = <0x00 0x75 0x04>;
		clocks = <0x15 0x11f 0x15 0x11c>;
		clock-names = "baudclk\0apb_pclk";
		dmas = <0x2e 0x02 0x2e 0x03>;
		pinctrl-0 = <0x90>;
		pinctrl-names = "default";
		reg-io-width = <0x04>;
		reg-shift = <0x02>;
		status = "disabled";
	};

	serial@fe660000 {
		compatible = "rockchip,rk3568-uart\0snps,dw-apb-uart";
		reg = <0x00 0xfe660000 0x00 0x100>;
		interrupts = <0x00 0x76 0x04>;
		clocks = <0x15 0x123 0x15 0x120>;
		clock-names = "baudclk\0apb_pclk";
		dmas = <0x2e 0x04 0x2e 0x05>;
		pinctrl-0 = <0x91>;
		pinctrl-names = "default";
		reg-io-width = <0x04>;
		reg-shift = <0x02>;
		status = "okay";
	};

	serial@fe670000 {
		compatible = "rockchip,rk3568-uart\0snps,dw-apb-uart";
		reg = <0x00 0xfe670000 0x00 0x100>;
		interrupts = <0x00 0x77 0x04>;
		clocks = <0x15 0x127 0x15 0x124>;
		clock-names = "baudclk\0apb_pclk";
		dmas = <0x2e 0x06 0x2e 0x07>;
		pinctrl-0 = <0x92>;
		pinctrl-names = "default";
		reg-io-width = <0x04>;
		reg-shift = <0x02>;
		status = "okay";
	};

	serial@fe680000 {
		compatible = "rockchip,rk3568-uart\0snps,dw-apb-uart";
		reg = <0x00 0xfe680000 0x00 0x100>;
		interrupts = <0x00 0x78 0x04>;
		clocks = <0x15 0x12b 0x15 0x128>;
		clock-names = "baudclk\0apb_pclk";
		dmas = <0x2e 0x08 0x2e 0x09>;
		pinctrl-0 = <0x93>;
		pinctrl-names = "default";
		reg-io-width = <0x04>;
		reg-shift = <0x02>;
		status = "disabled";
	};

	serial@fe690000 {
		compatible = "rockchip,rk3568-uart\0snps,dw-apb-uart";
		reg = <0x00 0xfe690000 0x00 0x100>;
		interrupts = <0x00 0x79 0x04>;
		clocks = <0x15 0x12f 0x15 0x12c>;
		clock-names = "baudclk\0apb_pclk";
		dmas = <0x2e 0x0a 0x2e 0x0b>;
		pinctrl-0 = <0x94>;
		pinctrl-names = "default";
		reg-io-width = <0x04>;
		reg-shift = <0x02>;
		status = "okay";
	};

	serial@fe6a0000 {
		compatible = "rockchip,rk3568-uart\0snps,dw-apb-uart";
		reg = <0x00 0xfe6a0000 0x00 0x100>;
		interrupts = <0x00 0x7a 0x04>;
		clocks = <0x15 0x133 0x15 0x130>;
		clock-names = "baudclk\0apb_pclk";
		dmas = <0x2e 0x0c 0x2e 0x0d>;
		pinctrl-0 = <0x95>;
		pinctrl-names = "default";
		reg-io-width = <0x04>;
		reg-shift = <0x02>;
		status = "disabled";
	};

	serial@fe6b0000 {
		compatible = "rockchip,rk3568-uart\0snps,dw-apb-uart";
		reg = <0x00 0xfe6b0000 0x00 0x100>;
		interrupts = <0x00 0x7b 0x04>;
		clocks = <0x15 0x137 0x15 0x134>;
		clock-names = "baudclk\0apb_pclk";
		dmas = <0x2e 0x0e 0x2e 0x0f>;
		pinctrl-0 = <0x96>;
		pinctrl-names = "default";
		reg-io-width = <0x04>;
		reg-shift = <0x02>;
		status = "disabled";
	};

	serial@fe6c0000 {
		compatible = "rockchip,rk3568-uart\0snps,dw-apb-uart";
		reg = <0x00 0xfe6c0000 0x00 0x100>;
		interrupts = <0x00 0x7c 0x04>;
		clocks = <0x15 0x13b 0x15 0x138>;
		clock-names = "baudclk\0apb_pclk";
		dmas = <0x2e 0x10 0x2e 0x11>;
		pinctrl-0 = <0x97>;
		pinctrl-names = "default";
		reg-io-width = <0x04>;
		reg-shift = <0x02>;
		status = "disabled";
	};

	serial@fe6d0000 {
		compatible = "rockchip,rk3568-uart\0snps,dw-apb-uart";
		reg = <0x00 0xfe6d0000 0x00 0x100>;
		interrupts = <0x00 0x7d 0x04>;
		clocks = <0x15 0x13f 0x15 0x13c>;
		clock-names = "baudclk\0apb_pclk";
		dmas = <0x2e 0x12 0x2e 0x13>;
		pinctrl-0 = <0x98>;
		pinctrl-names = "default";
		reg-io-width = <0x04>;
		reg-shift = <0x02>;
		status = "disabled";
	};

	thermal-zones {

		cpu-thermal {
			polling-delay-passive = <0x64>;
			polling-delay = <0x3e8>;
			thermal-sensors = <0x99 0x00>;

			trips {

				cpu_alert0 {
					temperature = <0x11170>;
					hysteresis = <0x7d0>;
					type = "passive";
				};

				cpu_alert1 {
					temperature = <0x124f8>;
					hysteresis = <0x7d0>;
					type = "passive";
				};

				cpu_crit {
					temperature = <0x17318>;
					hysteresis = <0x7d0>;
					type = "critical";
				};

				cpu-low {
					temperature = <0xc350>;
					hysteresis = <0x7d0>;
					type = "active";
					phandle = <0x9a>;
				};

				cpu-warm {
					temperature = <0xea60>;
					hysteresis = <0x7d0>;
					type = "active";
					phandle = <0x9c>;
				};

				cpu-hot {
					temperature = <0x11170>;
					hysteresis = <0x7d0>;
					type = "active";
					phandle = <0x9d>;
				};

				cpu-hall {
					temperature = <0x13880>;
					hysteresis = <0x7d0>;
					type = "active";
					phandle = <0x9e>;
				};
			};

			cooling-maps {

				map0 {
					trip = <0x9a>;
					cooling-device = <0x9b 0x00 0x01>;
				};

				map1 {
					trip = <0x9c>;
					cooling-device = <0x9b 0x01 0x02>;
				};

				map2 {
					trip = <0x9d>;
					cooling-device = <0x9b 0x02 0x04>;
				};

				map3 {
					trip = <0x9e>;
					cooling-device = <0x9b 0x04 0x05>;
				};
			};
		};

		gpu-thermal {
			polling-delay-passive = <0x14>;
			polling-delay = <0x3e8>;
			thermal-sensors = <0x99 0x01>;

			trips {

				gpu-threshold {
					temperature = <0x11170>;
					hysteresis = <0x7d0>;
					type = "passive";
				};

				gpu-target {
					temperature = <0x124f8>;
					hysteresis = <0x7d0>;
					type = "passive";
					phandle = <0x9f>;
				};

				gpu-crit {
					temperature = <0x17318>;
					hysteresis = <0x7d0>;
					type = "critical";
				};
			};

			cooling-maps {

				map0 {
					trip = <0x9f>;
					cooling-device = <0xa0 0xffffffff 0xffffffff>;
				};
			};
		};
	};

	tsadc@fe710000 {
		compatible = "rockchip,rk3568-tsadc";
		reg = <0x00 0xfe710000 0x00 0x100>;
		interrupts = <0x00 0x73 0x04>;
		assigned-clocks = <0x15 0x110 0x15 0x111>;
		assigned-clock-rates = <0x1036640 0xaae60>;
		clocks = <0x15 0x111 0x15 0x10f>;
		clock-names = "tsadc\0apb_pclk";
		resets = <0x15 0x181 0x15 0x182 0x15 0x1d7>;
		rockchip,grf = <0x25>;
		rockchip,hw-tshut-temp = <0x17318>;
		pinctrl-names = "default\0sleep";
		pinctrl-0 = <0xa1>;
		pinctrl-1 = <0xa2>;
		#thermal-sensor-cells = <0x01>;
		status = "okay";
		phandle = <0x99>;
	};

	saradc@fe720000 {
		compatible = "rockchip,rk3568-saradc\0rockchip,rk3399-saradc";
		reg = <0x00 0xfe720000 0x00 0x100>;
		interrupts = <0x00 0x5d 0x04>;
		clocks = <0x15 0x113 0x15 0x112>;
		clock-names = "saradc\0apb_pclk";
		resets = <0x15 0x180>;
		reset-names = "saradc-apb";
		#io-channel-cells = <0x01>;
		status = "okay";
		vref-supply = <0xa3>;
		phandle = <0xe6>;
	};

	pwm@fe6e0000 {
		compatible = "rockchip,rk3568-pwm\0rockchip,rk3328-pwm";
		reg = <0x00 0xfe6e0000 0x00 0x10>;
		clocks = <0x15 0x15a 0x15 0x159>;
		clock-names = "pwm\0pclk";
		pinctrl-0 = <0xa4>;
		pinctrl-names = "default";
		#pwm-cells = <0x03>;
		status = "disabled";
	};

	pwm@fe6e0010 {
		compatible = "rockchip,rk3568-pwm\0rockchip,rk3328-pwm";
		reg = <0x00 0xfe6e0010 0x00 0x10>;
		clocks = <0x15 0x15a 0x15 0x159>;
		clock-names = "pwm\0pclk";
		pinctrl-0 = <0xa5>;
		pinctrl-names = "default";
		#pwm-cells = <0x03>;
		status = "disabled";
	};

	pwm@fe6e0020 {
		compatible = "rockchip,rk3568-pwm\0rockchip,rk3328-pwm";
		reg = <0x00 0xfe6e0020 0x00 0x10>;
		clocks = <0x15 0x15a 0x15 0x159>;
		clock-names = "pwm\0pclk";
		pinctrl-0 = <0xa6>;
		pinctrl-names = "default";
		#pwm-cells = <0x03>;
		status = "disabled";
	};

	pwm@fe6e0030 {
		compatible = "rockchip,rk3568-pwm\0rockchip,rk3328-pwm";
		reg = <0x00 0xfe6e0030 0x00 0x10>;
		clocks = <0x15 0x15a 0x15 0x159>;
		clock-names = "pwm\0pclk";
		pinctrl-0 = <0xa7>;
		pinctrl-names = "default";
		#pwm-cells = <0x03>;
		status = "disabled";
	};

	pwm@fe6f0000 {
		compatible = "rockchip,rk3568-pwm\0rockchip,rk3328-pwm";
		reg = <0x00 0xfe6f0000 0x00 0x10>;
		clocks = <0x15 0x15d 0x15 0x15c>;
		clock-names = "pwm\0pclk";
		pinctrl-0 = <0xa8>;
		pinctrl-names = "default";
		#pwm-cells = <0x03>;
		status = "disabled";
	};

	pwm@fe6f0010 {
		compatible = "rockchip,rk3568-pwm\0rockchip,rk3328-pwm";
		reg = <0x00 0xfe6f0010 0x00 0x10>;
		clocks = <0x15 0x15d 0x15 0x15c>;
		clock-names = "pwm\0pclk";
		pinctrl-0 = <0xa9>;
		pinctrl-names = "default";
		#pwm-cells = <0x03>;
		status = "disabled";
	};

	pwm@fe6f0020 {
		compatible = "rockchip,rk3568-pwm\0rockchip,rk3328-pwm";
		reg = <0x00 0xfe6f0020 0x00 0x10>;
		clocks = <0x15 0x15d 0x15 0x15c>;
		clock-names = "pwm\0pclk";
		pinctrl-0 = <0xaa>;
		pinctrl-names = "default";
		#pwm-cells = <0x03>;
		status = "disabled";
	};

	pwm@fe6f0030 {
		compatible = "rockchip,rk3568-pwm\0rockchip,rk3328-pwm";
		reg = <0x00 0xfe6f0030 0x00 0x10>;
		clocks = <0x15 0x15d 0x15 0x15c>;
		clock-names = "pwm\0pclk";
		pinctrl-0 = <0xab>;
		pinctrl-names = "default";
		#pwm-cells = <0x03>;
		status = "disabled";
	};

	pwm@fe700000 {
		compatible = "rockchip,rk3568-pwm\0rockchip,rk3328-pwm";
		reg = <0x00 0xfe700000 0x00 0x10>;
		clocks = <0x15 0x160 0x15 0x15f>;
		clock-names = "pwm\0pclk";
		pinctrl-0 = <0xac>;
		pinctrl-names = "default";
		#pwm-cells = <0x03>;
		status = "disabled";
	};

	pwm@fe700010 {
		compatible = "rockchip,rk3568-pwm\0rockchip,rk3328-pwm";
		reg = <0x00 0xfe700010 0x00 0x10>;
		clocks = <0x15 0x160 0x15 0x15f>;
		clock-names = "pwm\0pclk";
		pinctrl-0 = <0xad>;
		pinctrl-names = "default";
		#pwm-cells = <0x03>;
		status = "disabled";
	};

	pwm@fe700020 {
		compatible = "rockchip,rk3568-pwm\0rockchip,rk3328-pwm";
		reg = <0x00 0xfe700020 0x00 0x10>;
		clocks = <0x15 0x160 0x15 0x15f>;
		clock-names = "pwm\0pclk";
		pinctrl-0 = <0xae>;
		pinctrl-names = "default";
		#pwm-cells = <0x03>;
		status = "disabled";
	};

	pwm@fe700030 {
		compatible = "rockchip,rk3568-pwm\0rockchip,rk3328-pwm";
		reg = <0x00 0xfe700030 0x00 0x10>;
		clocks = <0x15 0x160 0x15 0x15f>;
		clock-names = "pwm\0pclk";
		pinctrl-0 = <0xaf>;
		pinctrl-names = "default";
		#pwm-cells = <0x03>;
		status = "disabled";
	};

	phy@fe830000 {
		compatible = "rockchip,rk3568-naneng-combphy";
		reg = <0x00 0xfe830000 0x00 0x100>;
		clocks = <0x24 0x22 0x15 0x17d 0x15 0x7f>;
		clock-names = "ref\0apb\0pipe";
		assigned-clocks = <0x24 0x22>;
		assigned-clock-rates = <0x5f5e100>;
		resets = <0x15 0x1c7>;
		reset-names = "phy";
		rockchip,pipe-grf = <0xb0>;
		rockchip,pipe-phy-grf = <0xb1>;
		#phy-cells = <0x01>;
		status = "okay";
		phandle = <0x16>;
	};

	phy@fe840000 {
		compatible = "rockchip,rk3568-naneng-combphy";
		reg = <0x00 0xfe840000 0x00 0x100>;
		clocks = <0x24 0x25 0x15 0x17e 0x15 0x7f>;
		clock-names = "ref\0apb\0pipe";
		assigned-clocks = <0x24 0x25>;
		assigned-clock-rates = <0x5f5e100>;
		resets = <0x15 0x1c9>;
		reset-names = "phy";
		rockchip,pipe-grf = <0xb0>;
		rockchip,pipe-phy-grf = <0xb2>;
		#phy-cells = <0x01>;
		status = "okay";
		phandle = <0x18>;
	};

	phy@fe870000 {
		compatible = "rockchip,rk3568-csi-dphy";
		reg = <0x00 0xfe870000 0x00 0x10000>;
		clocks = <0x15 0x179>;
		clock-names = "pclk";
		#phy-cells = <0x00>;
		resets = <0x15 0x1ba>;
		reset-names = "apb";
		rockchip,grf = <0x25>;
		status = "disabled";
	};

	mipi-dphy@fe850000 {
		compatible = "rockchip,rk3568-dsi-dphy";
		reg = <0x00 0xfe850000 0x00 0x10000>;
		clock-names = "ref\0pclk";
		clocks = <0x24 0x17 0x15 0x17a>;
		#phy-cells = <0x00>;
		power-domains = <0x17 0x09>;
		reset-names = "apb";
		resets = <0x15 0x1bb>;
		status = "disabled";
		phandle = <0x56>;
	};

	mipi-dphy@fe860000 {
		compatible = "rockchip,rk3568-dsi-dphy";
		reg = <0x00 0xfe860000 0x00 0x10000>;
		clock-names = "ref\0pclk";
		clocks = <0x24 0x19 0x15 0x17b>;
		#phy-cells = <0x00>;
		power-domains = <0x17 0x09>;
		reset-names = "apb";
		resets = <0x15 0x1bc>;
		status = "disabled";
		phandle = <0x57>;
	};

	usb2phy@fe8a0000 {
		compatible = "rockchip,rk3568-usb2phy";
		reg = <0x00 0xfe8a0000 0x00 0x10000>;
		clocks = <0x24 0x13>;
		clock-names = "phyclk";
		clock-output-names = "clk_usbphy0_480m";
		interrupts = <0x00 0x87 0x04>;
		rockchip,usbgrf = <0xb3>;
		#clock-cells = <0x00>;
		status = "okay";
		phandle = <0x1a>;

		host-port {
			#phy-cells = <0x00>;
			status = "okay";
			phy-supply = <0xb4>;
			phandle = <0x1b>;
		};

		otg-port {
			#phy-cells = <0x00>;
			status = "okay";
			phy-supply = <0xb5>;
			phandle = <0x19>;
		};
	};

	usb2phy@fe8b0000 {
		compatible = "rockchip,rk3568-usb2phy";
		reg = <0x00 0xfe8b0000 0x00 0x10000>;
		clocks = <0x24 0x15>;
		clock-names = "phyclk";
		clock-output-names = "clk_usbphy1_480m";
		interrupts = <0x00 0x88 0x04>;
		rockchip,usbgrf = <0xb6>;
		#clock-cells = <0x00>;
		status = "okay";

		host-port {
			#phy-cells = <0x00>;
			status = "okay";
			phandle = <0x1d>;
		};

		otg-port {
			#phy-cells = <0x00>;
			status = "okay";
			phy-supply = <0xb4>;
			phandle = <0x1c>;
		};
	};

	pinctrl {
		compatible = "rockchip,rk3568-pinctrl";
		rockchip,grf = <0x25>;
		rockchip,pmu = <0x5f>;
		#address-cells = <0x02>;
		#size-cells = <0x02>;
		ranges;
		phandle = <0xb7>;

		gpio@fdd60000 {
			compatible = "rockchip,gpio-bank";
			reg = <0x00 0xfdd60000 0x00 0x100>;
			interrupts = <0x00 0x21 0x04>;
			clocks = <0x24 0x2e 0x24 0x0c>;
			gpio-controller;
			gpio-ranges = <0xb7 0x00 0x00 0x20>;
			#gpio-cells = <0x02>;
			interrupt-controller;
			#interrupt-cells = <0x02>;
			phandle = <0x28>;
		};

		gpio@fe740000 {
			compatible = "rockchip,gpio-bank";
			reg = <0x00 0xfe740000 0x00 0x100>;
			interrupts = <0x00 0x22 0x04>;
			clocks = <0x15 0x163 0x15 0x164>;
			gpio-controller;
			gpio-ranges = <0xb7 0x00 0x20 0x20>;
			#gpio-cells = <0x02>;
			interrupt-controller;
			#interrupt-cells = <0x02>;
		};

		gpio@fe750000 {
			compatible = "rockchip,gpio-bank";
			reg = <0x00 0xfe750000 0x00 0x100>;
			interrupts = <0x00 0x23 0x04>;
			clocks = <0x15 0x165 0x15 0x166>;
			gpio-controller;
			gpio-ranges = <0xb7 0x00 0x40 0x20>;
			#gpio-cells = <0x02>;
			interrupt-controller;
			#interrupt-cells = <0x02>;
		};

		gpio@fe760000 {
			compatible = "rockchip,gpio-bank";
			reg = <0x00 0xfe760000 0x00 0x100>;
			interrupts = <0x00 0x24 0x04>;
			clocks = <0x15 0x167 0x15 0x168>;
			gpio-controller;
			gpio-ranges = <0xb7 0x00 0x60 0x20>;
			#gpio-cells = <0x02>;
			interrupt-controller;
			#interrupt-cells = <0x02>;
			phandle = <0x63>;
		};

		gpio@fe770000 {
			compatible = "rockchip,gpio-bank";
			reg = <0x00 0xfe770000 0x00 0x100>;
			interrupts = <0x00 0x25 0x04>;
			clocks = <0x15 0x169 0x15 0x16a>;
			gpio-controller;
			gpio-ranges = <0xb7 0x00 0x80 0x20>;
			#gpio-cells = <0x02>;
			interrupt-controller;
			#interrupt-cells = <0x02>;
			phandle = <0xf0>;
		};

		pcfg-pull-up {
			bias-pull-up;
			phandle = <0xb9>;
		};

		pcfg-pull-down {
			bias-pull-down;
			phandle = <0xbd>;
		};

		pcfg-pull-none {
			bias-disable;
			phandle = <0x89>;
		};

		pcfg-pull-none-drv-level-1 {
			bias-disable;
			drive-strength = <0x01>;
			phandle = <0xbb>;
		};

		pcfg-pull-none-drv-level-2 {
			bias-disable;
			drive-strength = <0x02>;
			phandle = <0xba>;
		};

		pcfg-pull-none-drv-level-3 {
			bias-disable;
			drive-strength = <0x03>;
			phandle = <0xbf>;
		};

		pcfg-pull-up-drv-level-1 {
			bias-pull-up;
			drive-strength = <0x01>;
			phandle = <0xbe>;
		};

		pcfg-pull-up-drv-level-2 {
			bias-pull-up;
			drive-strength = <0x02>;
			phandle = <0xb8>;
		};

		pcfg-pull-none-smt {
			bias-disable;
			input-schmitt-enable;
			phandle = <0xbc>;
		};

		acodec {
		};

		audiopwm {
		};

		bt656 {
		};

		bt1120 {
		};

		cam {
		};

		can0 {

			can0m0-pins {
				rockchip,pins = <0x00 0x0c 0x02 0x89 0x00 0x0b 0x02 0x89>;
				phandle = <0xd0>;
			};
		};

		can1 {

			can1m0-pins {
				rockchip,pins = <0x01 0x00 0x03 0x89 0x01 0x01 0x03 0x89>;
				phandle = <0xd1>;
			};
		};

		can2 {

			can2m0-pins {
				rockchip,pins = <0x04 0x0c 0x03 0x89 0x04 0x0d 0x03 0x89>;
				phandle = <0xd2>;
			};
		};

		cif {
		};

		clk32k {

			clk32k-out0 {
				rockchip,pins = <0x00 0x08 0x02 0x89>;
				phandle = <0x14>;
			};
		};

		cpu {
		};

		ebc {
		};

		edpdp {
		};

		emmc {

			emmc-bus8 {
				rockchip,pins = <0x01 0x0c 0x01 0xb8 0x01 0x0d 0x01 0xb8 0x01 0x0e 0x01 0xb8 0x01 0x0f 0x01 0xb8 0x01 0x10 0x01 0xb8 0x01 0x11 0x01 0xb8 0x01 0x12 0x01 0xb8 0x01 0x13 0x01 0xb8>;
				phandle = <0x65>;
			};

			emmc-clk {
				rockchip,pins = <0x01 0x15 0x01 0xb8>;
				phandle = <0x66>;
			};

			emmc-cmd {
				rockchip,pins = <0x01 0x14 0x01 0xb8>;
				phandle = <0x67>;
			};

			emmc-datastrobe {
				rockchip,pins = <0x01 0x16 0x01 0x89>;
				phandle = <0x68>;
			};
		};

		eth0 {
		};

		eth1 {
		};

		flash {
		};

		fspi {

			fspi-pins {
				rockchip,pins = <0x01 0x18 0x01 0x89 0x01 0x1b 0x01 0x89 0x01 0x19 0x01 0x89 0x01 0x1a 0x01 0x89 0x01 0x17 0x02 0x89 0x01 0x1c 0x01 0x89>;
				phandle = <0x64>;
			};
		};

		gmac0 {

			gmac0-miim {
				rockchip,pins = <0x02 0x13 0x02 0x89 0x02 0x14 0x02 0x89>;
				phandle = <0xc9>;
			};

			gmac0-rx-bus2 {
				rockchip,pins = <0x02 0x0e 0x01 0x89 0x02 0x0f 0x02 0x89 0x02 0x10 0x02 0x89>;
				phandle = <0xcb>;
			};

			gmac0-tx-bus2 {
				rockchip,pins = <0x02 0x0b 0x01 0xba 0x02 0x0c 0x01 0xba 0x02 0x0d 0x01 0x89>;
				phandle = <0xca>;
			};

			gmac0-rgmii-clk {
				rockchip,pins = <0x02 0x05 0x02 0x89 0x02 0x08 0x02 0xbb>;
				phandle = <0xcc>;
			};

			gmac0-rgmii-bus {
				rockchip,pins = <0x02 0x03 0x02 0x89 0x02 0x04 0x02 0x89 0x02 0x06 0x02 0xba 0x02 0x07 0x02 0xba>;
				phandle = <0xcd>;
			};
		};

		gmac1 {
		};

		gpu {
		};

		hdmitx {

			hdmitxm0-cec {
				rockchip,pins = <0x04 0x19 0x01 0x89>;
				phandle = <0x5a>;
			};

			hdmitx-scl {
				rockchip,pins = <0x04 0x17 0x01 0x89>;
				phandle = <0x58>;
			};

			hdmitx-sda {
				rockchip,pins = <0x04 0x18 0x01 0x89>;
				phandle = <0x59>;
			};
		};

		i2c0 {

			i2c0-xfer {
				rockchip,pins = <0x00 0x09 0x01 0xbc 0x00 0x0a 0x01 0xbc>;
				phandle = <0x26>;
			};
		};

		i2c1 {

			i2c1-xfer {
				rockchip,pins = <0x00 0x0b 0x01 0xbc 0x00 0x0c 0x01 0xbc>;
				phandle = <0x81>;
			};
		};

		i2c2 {

			i2c2m0-xfer {
				rockchip,pins = <0x00 0x0d 0x01 0xbc 0x00 0x0e 0x01 0xbc>;
				phandle = <0x82>;
			};
		};

		i2c3 {

			i2c3m0-xfer {
				rockchip,pins = <0x01 0x01 0x01 0xbc 0x01 0x00 0x01 0xbc>;
				phandle = <0x83>;
			};
		};

		i2c4 {

			i2c4m0-xfer {
				rockchip,pins = <0x04 0x0b 0x01 0xbc 0x04 0x0a 0x01 0xbc>;
				phandle = <0x84>;
			};
		};

		i2c5 {

			i2c5m0-xfer {
				rockchip,pins = <0x03 0x0b 0x04 0xbc 0x03 0x0c 0x04 0xbc>;
				phandle = <0x85>;
			};
		};

		i2s1 {

			i2s1m0-lrckrx {
				rockchip,pins = <0x01 0x06 0x01 0x89>;
				phandle = <0x6d>;
			};

			i2s1m0-lrcktx {
				rockchip,pins = <0x01 0x05 0x01 0x89>;
				phandle = <0x6c>;
			};

			i2s1m0-mclk {
				rockchip,pins = <0x01 0x02 0x01 0x89>;
				phandle = <0x2d>;
			};

			i2s1m0-sclkrx {
				rockchip,pins = <0x01 0x04 0x01 0x89>;
				phandle = <0x6b>;
			};

			i2s1m0-sclktx {
				rockchip,pins = <0x01 0x03 0x01 0x89>;
				phandle = <0x6a>;
			};

			i2s1m0-sdi0 {
				rockchip,pins = <0x01 0x0b 0x01 0x89>;
				phandle = <0x6e>;
			};

			i2s1m0-sdi1 {
				rockchip,pins = <0x01 0x0a 0x02 0x89>;
				phandle = <0x6f>;
			};

			i2s1m0-sdi2 {
				rockchip,pins = <0x01 0x09 0x02 0x89>;
				phandle = <0x70>;
			};

			i2s1m0-sdi3 {
				rockchip,pins = <0x01 0x08 0x02 0x89>;
				phandle = <0x71>;
			};

			i2s1m0-sdo0 {
				rockchip,pins = <0x01 0x07 0x01 0x89>;
				phandle = <0x72>;
			};

			i2s1m0-sdo1 {
				rockchip,pins = <0x01 0x08 0x01 0x89>;
				phandle = <0x73>;
			};

			i2s1m0-sdo2 {
				rockchip,pins = <0x01 0x09 0x01 0x89>;
				phandle = <0x74>;
			};

			i2s1m0-sdo3 {
				rockchip,pins = <0x01 0x0a 0x01 0x89>;
				phandle = <0x75>;
			};
		};

		i2s2 {

			i2s2m0-lrcktx {
				rockchip,pins = <0x02 0x13 0x01 0x89>;
				phandle = <0x77>;
			};

			i2s2m0-sclktx {
				rockchip,pins = <0x02 0x12 0x01 0x89>;
				phandle = <0x76>;
			};

			i2s2m0-sdi {
				rockchip,pins = <0x02 0x15 0x01 0x89>;
				phandle = <0x78>;
			};

			i2s2m0-sdo {
				rockchip,pins = <0x02 0x14 0x01 0x89>;
				phandle = <0x79>;
			};
		};

		i2s3 {
		};

		isp {
		};

		jtag {
		};

		lcdc {
		};

		mcu {
		};

		npu {
		};

		pcie20 {
		};

		pcie30x1 {
		};

		pcie30x2 {
		};

		pdm {

			pdmm0-clk {
				rockchip,pins = <0x01 0x06 0x03 0x89>;
				phandle = <0x7a>;
			};

			pdmm0-clk1 {
				rockchip,pins = <0x01 0x04 0x03 0x89>;
				phandle = <0x7b>;
			};

			pdmm0-sdi0 {
				rockchip,pins = <0x01 0x0b 0x02 0x89>;
				phandle = <0x7c>;
			};

			pdmm0-sdi1 {
				rockchip,pins = <0x01 0x0a 0x03 0x89>;
				phandle = <0x7d>;
			};

			pdmm0-sdi2 {
				rockchip,pins = <0x01 0x09 0x03 0x89>;
				phandle = <0x7e>;
			};

			pdmm0-sdi3 {
				rockchip,pins = <0x01 0x08 0x03 0x89>;
				phandle = <0x7f>;
			};
		};

		pmic {

			pmic_int {
				rockchip,pins = <0x00 0x03 0x00 0xb9>;
				phandle = <0x29>;
			};

			soc_slppin_gpio {
				rockchip,pins = <0x00 0x02 0x00 0xbd>;
			};

			soc_slppin_slp {
				rockchip,pins = <0x00 0x02 0x01 0xb9>;
				phandle = <0x2a>;
			};

			soc_slppin_rst {
				rockchip,pins = <0x00 0x02 0x02 0x89>;
			};
		};

		pmu {
		};

		pwm0 {

			pwm0m1-pins {
				rockchip,pins = <0x00 0x17 0x02 0x89>;
				phandle = <0x30>;
			};
		};

		pwm1 {

			pwm1m0-pins {
				rockchip,pins = <0x00 0x10 0x01 0x89>;
				phandle = <0x31>;
			};
		};

		pwm2 {

			pwm2m0-pins {
				rockchip,pins = <0x00 0x11 0x01 0x89>;
				phandle = <0x32>;
			};
		};

		pwm3 {

			pwm3-pins {
				rockchip,pins = <0x00 0x12 0x01 0x89>;
				phandle = <0x33>;
			};
		};

		pwm4 {

			pwm4-pins {
				rockchip,pins = <0x00 0x13 0x01 0x89>;
				phandle = <0xa4>;
			};
		};

		pwm5 {

			pwm5-pins {
				rockchip,pins = <0x00 0x14 0x01 0x89>;
				phandle = <0xa5>;
			};
		};

		pwm6 {

			pwm6-pins {
				rockchip,pins = <0x00 0x15 0x01 0x89>;
				phandle = <0xa6>;
			};
		};

		pwm7 {

			pwm7-pins {
				rockchip,pins = <0x00 0x16 0x01 0x89>;
				phandle = <0xa7>;
			};
		};

		pwm8 {

			pwm8m0-pins {
				rockchip,pins = <0x03 0x09 0x05 0x89>;
				phandle = <0xa8>;
			};
		};

		pwm9 {

			pwm9m0-pins {
				rockchip,pins = <0x03 0x0a 0x05 0x89>;
				phandle = <0xa9>;
			};
		};

		pwm10 {

			pwm10m0-pins {
				rockchip,pins = <0x03 0x0d 0x05 0x89>;
				phandle = <0xaa>;
			};
		};

		pwm11 {

			pwm11m0-pins {
				rockchip,pins = <0x03 0x0e 0x05 0x89>;
				phandle = <0xab>;
			};
		};

		pwm12 {

			pwm12m0-pins {
				rockchip,pins = <0x03 0x0f 0x02 0x89>;
				phandle = <0xac>;
			};
		};

		pwm13 {

			pwm13m0-pins {
				rockchip,pins = <0x03 0x10 0x02 0x89>;
				phandle = <0xad>;
			};
		};

		pwm14 {

			pwm14m0-pins {
				rockchip,pins = <0x03 0x14 0x01 0x89>;
				phandle = <0xae>;
			};
		};

		pwm15 {

			pwm15m0-pins {
				rockchip,pins = <0x03 0x15 0x01 0x89>;
				phandle = <0xaf>;
			};
		};

		refclk {
		};

		sata {

			vcc12v_sata_enable_h {
				rockchip,pins = <0x03 0x01 0x00 0x89>;
				phandle = <0xe7>;
			};

			asm1064_rst {
				rockchip,pins = <0x03 0x04 0x00 0x89>;
				phandle = <0x62>;
			};
		};

		sata0 {
		};

		sata1 {
		};

		sata2 {
		};

		scr {
		};

		sdmmc0 {
		};

		sdmmc1 {
		};

		sdmmc2 {
		};

		spdif {

			spdifm0-tx {
				rockchip,pins = <0x01 0x04 0x04 0x89>;
				phandle = <0x80>;
			};
		};

		spi0 {

			spi0m0-pins {
				rockchip,pins = <0x00 0x0d 0x02 0x89 0x00 0x15 0x02 0x89 0x00 0x0e 0x02 0x89>;
				phandle = <0x88>;
			};

			spi0m0-cs0 {
				rockchip,pins = <0x00 0x16 0x02 0x89>;
				phandle = <0x86>;
			};

			spi0m0-cs1 {
				rockchip,pins = <0x00 0x14 0x02 0x89>;
				phandle = <0x87>;
			};
		};

		spi1 {
		};

		spi2 {

			spi2m0-pins {
				rockchip,pins = <0x02 0x11 0x04 0x89 0x02 0x12 0x04 0x89 0x02 0x13 0x04 0x89>;
				phandle = <0x8c>;
			};

			spi2m0-cs0 {
				rockchip,pins = <0x02 0x14 0x04 0x89>;
				phandle = <0x8a>;
			};

			spi2m0-cs1 {
				rockchip,pins = <0x02 0x15 0x04 0x89>;
				phandle = <0x8b>;
			};
		};

		spi3 {

			spi3m0-pins {
				rockchip,pins = <0x04 0x0b 0x04 0x89 0x04 0x08 0x04 0x89 0x04 0x0a 0x04 0x89>;
				phandle = <0x8f>;
			};

			spi3m0-cs0 {
				rockchip,pins = <0x04 0x06 0x04 0x89>;
				phandle = <0x8d>;
			};

			spi3m0-cs1 {
				rockchip,pins = <0x04 0x07 0x04 0x89>;
				phandle = <0x8e>;
			};
		};

		tsadc {

			tsadc-shutorg {
				rockchip,pins = <0x00 0x01 0x02 0x89>;
				phandle = <0xa1>;
			};

			tsadc-pin {
				rockchip,pins = <0x00 0x01 0x00 0x89>;
				phandle = <0xa2>;
			};
		};

		uart0 {

			uart0-xfer {
				rockchip,pins = <0x00 0x10 0x03 0xb9 0x00 0x11 0x03 0xb9>;
				phandle = <0x2f>;
			};
		};

		uart1 {

			uart1m0-xfer {
				rockchip,pins = <0x02 0x0b 0x02 0xb9 0x02 0x0c 0x02 0xb9>;
				phandle = <0x90>;
			};
		};

		uart2 {

			uart2m0-xfer {
				rockchip,pins = <0x00 0x18 0x01 0xb9 0x00 0x19 0x01 0xb9>;
				phandle = <0x91>;
			};
		};

		uart3 {

			uart3m1-xfer {
				rockchip,pins = <0x03 0x10 0x04 0xb9 0x03 0x0f 0x04 0xb9>;
				phandle = <0x92>;
			};
		};

		uart4 {

			uart4m0-xfer {
				rockchip,pins = <0x01 0x04 0x02 0xb9 0x01 0x06 0x02 0xb9>;
				phandle = <0x93>;
			};
		};

		uart5 {

			uart5m1-xfer {
				rockchip,pins = <0x03 0x13 0x04 0xb9 0x03 0x12 0x04 0xb9>;
				phandle = <0x94>;
			};
		};

		uart6 {

			uart6m0-xfer {
				rockchip,pins = <0x02 0x03 0x03 0xb9 0x02 0x04 0x03 0xb9>;
				phandle = <0x95>;
			};
		};

		uart7 {

			uart7m0-xfer {
				rockchip,pins = <0x02 0x05 0x03 0xb9 0x02 0x06 0x03 0xb9>;
				phandle = <0x96>;
			};
		};

		uart8 {

			uart8m0-xfer {
				rockchip,pins = <0x02 0x16 0x02 0xb9 0x02 0x15 0x03 0xb9>;
				phandle = <0x97>;
			};
		};

		uart9 {

			uart9m0-xfer {
				rockchip,pins = <0x02 0x07 0x03 0xb9 0x02 0x08 0x03 0xb9>;
				phandle = <0x98>;
			};
		};

		vop {
		};

		spi0-hs {
		};

		spi1-hs {
		};

		spi2-hs {
		};

		spi3-hs {
		};

		gmac-txd-level3 {
		};

		gmac-txc-level2 {
		};

		wireless-wlan {

			wifi-host-wake-irq {
				rockchip,pins = <0x03 0x1c 0x00 0xb9>;
				phandle = <0xeb>;
			};
		};

		usb {

			vcc5v0-otg-en {
				rockchip,pins = <0x00 0x05 0x00 0x89>;
				phandle = <0xea>;
			};
		};

		gpio-leds {

			heartbeat-pin {
				rockchip,pins = <0x03 0x1d 0x00 0x89>;
				phandle = <0xed>;
			};

			wifi-pwr-pin {
				rockchip,pins = <0x03 0x1c 0x00 0x89>;
				phandle = <0xee>;
			};

			pcie-pwr-pin {
				rockchip,pins = <0x04 0x14 0x00 0x89>;
				phandle = <0xef>;
			};
		};

		fan-fg {

			fg-pin {
				rockchip,pins = <0x00 0x14 0x00 0xb9>;
			};
		};

		pcie {

			pcie-reset-h {
				rockchip,pins = <0x00 0x16 0x00 0x89>;
				phandle = <0xe9>;
			};
		};
	};

	sata@fc000000 {
		compatible = "rockchip,rk3568-dwc-ahci\0snps,dwc-ahci";
		reg = <0x00 0xfc000000 0x00 0x1000>;
		clocks = <0x15 0x96 0x15 0x97 0x15 0x98>;
		clock-names = "sata\0pmalive\0rxoob";
		interrupts = <0x00 0x5e 0x04>;
		phys = <0xc0 0x01>;
		phy-names = "sata-phy";
		ports-implemented = <0x01>;
		power-domains = <0x17 0x0f>;
		status = "disabled";
	};

	syscon@fdc70000 {
		compatible = "rockchip,rk3568-pipe-phy-grf\0syscon";
		reg = <0x00 0xfdc70000 0x00 0x1000>;
		phandle = <0xd3>;
	};

	qos@fe190080 {
		compatible = "rockchip,rk3568-qos\0syscon";
		reg = <0x00 0xfe190080 0x00 0x20>;
		phandle = <0x47>;
	};

	qos@fe190100 {
		compatible = "rockchip,rk3568-qos\0syscon";
		reg = <0x00 0xfe190100 0x00 0x20>;
		phandle = <0x48>;
	};

	qos@fe190200 {
		compatible = "rockchip,rk3568-qos\0syscon";
		reg = <0x00 0xfe190200 0x00 0x20>;
		phandle = <0x49>;
	};

	syscon@fdcb8000 {
		compatible = "rockchip,rk3568-pcie3-phy-grf\0syscon";
		reg = <0x00 0xfdcb8000 0x00 0x10000>;
		phandle = <0xc1>;
	};

	phy@fe8c0000 {
		compatible = "rockchip,rk3568-pcie3-phy";
		reg = <0x00 0xfe8c0000 0x00 0x20000>;
		#phy-cells = <0x00>;
		clocks = <0x24 0x26 0x24 0x27 0x15 0x177>;
		clock-names = "refclk_m\0refclk_n\0pclk";
		resets = <0x15 0x1be>;
		reset-names = "phy";
		rockchip,phy-grf = <0xc1>;
		status = "okay";
		phandle = <0xc3>;
	};

	pcie@fe270000 {
		compatible = "rockchip,rk3568-pcie";
		#address-cells = <0x03>;
		#size-cells = <0x02>;
		bus-range = <0x10 0x1f>;
		clocks = <0x15 0x88 0x15 0x89 0x15 0x8a 0x15 0x8b 0x15 0x8c>;
		clock-names = "aclk_mst\0aclk_slv\0aclk_dbi\0pclk\0aux";
		device_type = "pci";
		interrupts = <0x00 0xa0 0x04 0x00 0x9f 0x04 0x00 0x9e 0x04 0x00 0x9d 0x04 0x00 0x9c 0x04>;
		interrupt-names = "sys\0pmc\0msg\0legacy\0err";
		#interrupt-cells = <0x01>;
		interrupt-map-mask = <0x00 0x00 0x00 0x07>;
		interrupt-map = <0x00 0x00 0x00 0x01 0xc2 0x00 0x00 0x00 0x00 0x02 0xc2 0x01 0x00 0x00 0x00 0x03 0xc2 0x02 0x00 0x00 0x00 0x04 0xc2 0x03>;
		linux,pci-domain = <0x01>;
		num-ib-windows = <0x06>;
		num-ob-windows = <0x02>;
		max-link-speed = <0x03>;
		msi-map = <0x1000 0x61 0x1000 0x1000>;
		num-lanes = <0x01>;
		phys = <0xc3>;
		phy-names = "pcie-phy";
		power-domains = <0x17 0x0f>;
		reg = <0x03 0xc0400000 0x00 0x400000 0x00 0xfe270000 0x00 0x10000 0x00 0xf2000000 0x00 0x100000>;
		ranges = <0x1000000 0x00 0xf2100000 0x00 0xf2100000 0x00 0x100000 0x2000000 0x00 0xf2200000 0x00 0xf2200000 0x00 0x1e00000 0x3000000 0x00 0x40000000 0x03 0x40000000 0x00 0x40000000>;
		reg-names = "dbi\0apb\0config";
		resets = <0x15 0xb1>;
		reset-names = "pipe";
		status = "disabled";

		legacy-interrupt-controller {
			interrupt-controller;
			#address-cells = <0x00>;
			#interrupt-cells = <0x01>;
			interrupt-parent = <0x01>;
			interrupts = <0x00 0x9d 0x01>;
			phandle = <0xc2>;
		};
	};

	pcie@fe280000 {
		compatible = "rockchip,rk3568-pcie";
		#address-cells = <0x03>;
		#size-cells = <0x02>;
		bus-range = <0x20 0x2f>;
		clocks = <0x15 0x8f 0x15 0x90 0x15 0x91 0x15 0x92 0x15 0x93>;
		clock-names = "aclk_mst\0aclk_slv\0aclk_dbi\0pclk\0aux";
		device_type = "pci";
		interrupts = <0x00 0xa5 0x04 0x00 0xa4 0x04 0x00 0xa3 0x04 0x00 0xa2 0x04 0x00 0xa1 0x04>;
		interrupt-names = "sys\0pmc\0msg\0legacy\0err";
		#interrupt-cells = <0x01>;
		interrupt-map-mask = <0x00 0x00 0x00 0x07>;
		interrupt-map = <0x00 0x00 0x00 0x01 0xc4 0x00 0x00 0x00 0x00 0x02 0xc4 0x01 0x00 0x00 0x00 0x03 0xc4 0x02 0x00 0x00 0x00 0x04 0xc4 0x03>;
		linux,pci-domain = <0x02>;
		num-ib-windows = <0x06>;
		num-ob-windows = <0x02>;
		max-link-speed = <0x03>;
		msi-map = <0x2000 0x61 0x2000 0x1000>;
		num-lanes = <0x02>;
		phys = <0xc3>;
		phy-names = "pcie-phy";
		power-domains = <0x17 0x0f>;
		reg = <0x03 0xc0800000 0x00 0x400000 0x00 0xfe280000 0x00 0x10000 0x00 0xf0000000 0x00 0x100000>;
		ranges = <0x1000000 0x00 0xf0100000 0x00 0xf0100000 0x00 0x100000 0x2000000 0x00 0xf0200000 0x00 0xf0200000 0x00 0x1e00000 0x3000000 0x00 0x40000000 0x03 0x80000000 0x00 0x40000000>;
		reg-names = "dbi\0apb\0config";
		resets = <0x15 0xc1>;
		reset-names = "pipe";
		status = "okay";
		pinctrl-names = "default";
		reset-gpios = <0x28 0x16 0x00>;
		vpcie3v3-supply = <0xc5>;

		legacy-interrupt-controller {
			interrupt-controller;
			#address-cells = <0x00>;
			#interrupt-cells = <0x01>;
			interrupt-parent = <0x01>;
			interrupts = <0x00 0xa2 0x01>;
			phandle = <0xc4>;
		};
	};

	ethernet@fe2a0000 {
		compatible = "rockchip,rk3568-gmac\0snps,dwmac-4.20a";
		reg = <0x00 0xfe2a0000 0x00 0x10000>;
		interrupts = <0x00 0x1b 0x04 0x00 0x18 0x04>;
		interrupt-names = "macirq\0eth_wake_irq";
		clocks = <0x15 0x182 0x15 0x185 0x15 0x185 0x15 0xb8 0x15 0xb4 0x15 0xb5 0x15 0x185 0x15 0xb9 0x15 0xac>;
		clock-names = "stmmaceth\0mac_clk_rx\0mac_clk_tx\0clk_mac_refout\0aclk_mac\0pclk_mac\0clk_mac_speed\0ptp_ref\0pclk_xpcs";
		resets = <0x15 0xd7>;
		reset-names = "stmmaceth";
		rockchip,grf = <0x25>;
		snps,axi-config = <0xc6>;
		snps,mixed-burst;
		snps,mtl-rx-config = <0xc7>;
		snps,mtl-tx-config = <0xc8>;
		snps,tso;
		status = "okay";
		phy-mode = "rgmii";
		clock_in_out = "input";
		snps,reset-gpio = <0x63 0x07 0x01>;
		snps,reset-active-low;
		snps,reset-delays-us = <0x00 0x4e20 0x186a0>;
		assigned-clocks = <0x15 0x185 0x15 0x182>;
		assigned-clock-parents = <0x15 0x183 0x15 0xb6>;
		assigned-clock-rates = <0x00 0x7735940>;
		pinctrl-names = "default";
		pinctrl-0 = <0xc9 0xca 0xcb 0xcc 0xcd>;
		tx_delay = <0x2e>;
		rx_delay = <0x2a>;
		phy-handle = <0xce>;
		phy-supply = <0xcf>;

		mdio {
			compatible = "snps,dwmac-mdio";
			#address-cells = <0x01>;
			#size-cells = <0x00>;

			phy@0 {
				compatible = "ethernet-phy-ieee802.3-c22";
				reg = <0x00>;
				phandle = <0xce>;
			};
		};

		stmmac-axi-config {
			snps,blen = <0x00 0x00 0x00 0x00 0x10 0x08 0x04>;
			snps,rd_osr_lmt = <0x08>;
			snps,wr_osr_lmt = <0x04>;
			phandle = <0xc6>;
		};

		rx-queues-config {
			snps,rx-queues-to-use = <0x01>;
			phandle = <0xc7>;

			queue0 {
			};
		};

		tx-queues-config {
			snps,tx-queues-to-use = <0x01>;
			phandle = <0xc8>;

			queue0 {
			};
		};
	};

	can@fe570000 {
		compatible = "rockchip,rk3568v2-canfd";
		reg = <0x00 0xfe570000 0x00 0x1000>;
		interrupts = <0x00 0x01 0x04>;
		clocks = <0x15 0x141 0x15 0x140>;
		clock-names = "baud\0pclk";
		resets = <0x15 0x155 0x15 0x154>;
		reset-names = "core\0apb";
		pinctrl-names = "default";
		pinctrl-0 = <0xd0>;
		status = "disabled";
	};

	can@fe580000 {
		compatible = "rockchip,rk3568v2-canfd";
		reg = <0x00 0xfe580000 0x00 0x1000>;
		interrupts = <0x00 0x02 0x04>;
		clocks = <0x15 0x143 0x15 0x142>;
		clock-names = "baud\0pclk";
		resets = <0x15 0x157 0x15 0x156>;
		reset-names = "core\0apb";
		pinctrl-names = "default";
		pinctrl-0 = <0xd1>;
		status = "disabled";
	};

	can@fe590000 {
		compatible = "rockchip,rk3568v2-canfd";
		reg = <0x00 0xfe590000 0x00 0x1000>;
		interrupts = <0x00 0x03 0x04>;
		clocks = <0x15 0x145 0x15 0x144>;
		clock-names = "baud\0pclk";
		resets = <0x15 0x159 0x15 0x158>;
		reset-names = "core\0apb";
		pinctrl-names = "default";
		pinctrl-0 = <0xd2>;
		status = "disabled";
	};

	phy@fe820000 {
		compatible = "rockchip,rk3568-naneng-combphy";
		reg = <0x00 0xfe820000 0x00 0x100>;
		clocks = <0x24 0x1f 0x15 0x17c 0x15 0x7f>;
		clock-names = "ref\0apb\0pipe";
		assigned-clocks = <0x24 0x1f>;
		assigned-clock-rates = <0x5f5e100>;
		resets = <0x15 0x1c5>;
		reset-names = "phy";
		rockchip,pipe-grf = <0xb0>;
		rockchip,pipe-phy-grf = <0xd3>;
		#phy-cells = <0x01>;
		status = "okay";
		phandle = <0xc0>;
	};

	rockchip-system-monitor {
		compatible = "rockchip,system-monitor";
		rockchip,thermal-zone = "cpu-thermal";
		status = "disabled";
	};

	otp@fe38c000 {
		compatible = "rockchip,rk3568-otp";
		reg = <0x00 0xfe38c000 0x00 0x4000>;
		#address-cells = <0x01>;
		#size-cells = <0x01>;
		clocks = <0x15 0x73 0x15 0x72 0x15 0x71 0x15 0x181>;
		clock-names = "usr\0sbpi\0apb\0phy";
		resets = <0x15 0x1cf>;
		reset-names = "otp_phy";

		specification-serial-number@7 {
			reg = <0x07 0x01>;
			bits = <0x00 0x05>;
			phandle = <0x0c>;
		};

		mbist-vmin@9 {
			reg = <0x09 0x01>;
			bits = <0x00 0x04>;
			phandle = <0x0a>;
		};

		log-leakage@1b {
			reg = <0x1b 0x01>;
			phandle = <0xde>;
		};

		core-pvtm@2a {
			reg = <0x2a 0x02>;
			phandle = <0x09>;
		};

		remark-spec-serial-number@56 {
			reg = <0x56 0x01>;
			bits = <0x00 0x05>;
			phandle = <0x0d>;
		};

		gpu-leakage@1d {
			reg = <0x1d 0x01>;
			phandle = <0x08>;
		};

		gpu-opp-info@3c {
			reg = <0x3c 0x06>;
			phandle = <0x0b>;
		};

		npu-leakage@1c {
			reg = <0x1c 0x01>;
			phandle = <0xe2>;
		};

		npu-opp-info@42 {
			reg = <0x42 0x06>;
			phandle = <0xe3>;
		};
	};

	sram@fdcc0000 {
		compatible = "mmio-sram";
		reg = <0x00 0xfdcc0000 0x00 0xb000>;
		#address-cells = <0x01>;
		#size-cells = <0x01>;
		ranges = <0x00 0x00 0xfdcc0000 0xb000>;

		rkvdec-sram@0 {
			reg = <0x00 0xb000>;
			phandle = <0xdd>;
		};
	};

	mpp-srv {
		compatible = "rockchip,mpp-service";
		rockchip,taskqueue-count = <0x06>;
		rockchip,resetgroup-count = <0x06>;
		status = "okay";
		phandle = <0xd5>;
	};

	vdpu@fdea0400 {
		compatible = "rockchip,vpu-decoder-v2";
		reg = <0x00 0xfdea0400 0x00 0x400>;
		interrupts = <0x00 0x8b 0x04>;
		interrupt-names = "irq_dec";
		clocks = <0x15 0xee 0x15 0xef>;
		clock-names = "aclk_vcodec\0hclk_vcodec";
		resets = <0x15 0x11a 0x15 0x11b>;
		reset-names = "video_a\0video_h";
		iommus = <0xd4>;
		power-domains = <0x17 0x0b>;
		rockchip,srv = <0xd5>;
		rockchip,taskqueue-node = <0x00>;
		rockchip,resetgroup-node = <0x00>;
		status = "okay";
		memory-region = <0xd6>;
	};

	rk_rga@fdeb0000 {
		compatible = "rockchip,rga2";
		reg = <0x00 0xfdeb0000 0x00 0x1000>;
		interrupts = <0x00 0x5a 0x04>;
		clocks = <0x15 0xf3 0x15 0xf4 0x15 0xf5>;
		clock-names = "aclk_rga\0hclk_rga\0clk_rga";
		power-domains = <0x17 0x0a>;
		status = "okay";
	};

	jpegd@fded0000 {
		compatible = "rockchip,rkv-jpeg-decoder-v1";
		reg = <0x00 0xfded0000 0x00 0x400>;
		interrupts = <0x00 0x3e 0x04>;
		clocks = <0x15 0xfb 0x15 0xfc>;
		clock-names = "aclk_vcodec\0hclk_vcodec";
		rockchip,disable-auto-freq;
		resets = <0x15 0x12c 0x15 0x12d>;
		reset-names = "video_a\0video_h";
		iommus = <0xd7>;
		rockchip,srv = <0xd5>;
		rockchip,taskqueue-node = <0x01>;
		rockchip,resetgroup-node = <0x01>;
		power-domains = <0x17 0x0a>;
		status = "okay";
	};

	iommu@fded0480 {
		compatible = "rockchip,rk3568-iommu\0rockchip,iommu-v2";
		reg = <0x00 0xfded0480 0x00 0x40>;
		interrupts = <0x00 0x3d 0x04>;
		interrupt-names = "jpegd_mmu";
		clock-names = "aclk\0iface";
		clocks = <0x15 0xfb 0x15 0xfc>;
		power-domains = <0x17 0x0a>;
		#iommu-cells = <0x00>;
		status = "okay";
		phandle = <0xd7>;
	};

	vepu@fdee0000 {
		compatible = "rockchip,vpu-encoder-v2";
		reg = <0x00 0xfdee0000 0x00 0x400>;
		interrupts = <0x00 0x40 0x04>;
		clocks = <0x15 0xfd 0x15 0xfe>;
		clock-names = "aclk_vcodec\0hclk_vcodec";
		rockchip,disable-auto-freq;
		resets = <0x15 0x12e 0x15 0x12f>;
		reset-names = "video_a\0video_h";
		iommus = <0xd8>;
		rockchip,srv = <0xd5>;
		rockchip,taskqueue-node = <0x02>;
		rockchip,resetgroup-node = <0x02>;
		power-domains = <0x17 0x0a>;
		status = "okay";
		memory-region = <0xd6>;
	};

	iep@fdef0000 {
		compatible = "rockchip,iep-v2";
		reg = <0x00 0xfdef0000 0x00 0x500>;
		interrupts = <0x00 0x38 0x04>;
		clocks = <0x15 0xf6 0x15 0xf7 0x15 0xf8>;
		clock-names = "aclk\0hclk\0sclk";
		resets = <0x15 0x127 0x15 0x128 0x15 0x129>;
		reset-names = "rst_a\0rst_h\0rst_s";
		power-domains = <0x17 0x0a>;
		rockchip,srv = <0xd5>;
		rockchip,taskqueue-node = <0x05>;
		rockchip,resetgroup-node = <0x05>;
		iommus = <0xd9>;
		status = "okay";
	};

	iommu@fdef0800 {
		compatible = "rockchip,rk3568-iommu\0rockchip,iommu-v2";
		reg = <0x00 0xfdef0800 0x00 0x100>;
		interrupts = <0x00 0x38 0x04>;
		interrupt-names = "iep_mmu";
		clocks = <0x15 0xf6 0x15 0xf7>;
		clock-names = "aclk\0iface";
		#iommu-cells = <0x00>;
		power-domains = <0x17 0x0a>;
		status = "okay";
		phandle = <0xd9>;
	};

	rkvenc@fdf40000 {
		compatible = "rockchip,rkv-encoder-v1";
		reg = <0x00 0xfdf40000 0x00 0x400>;
		interrupts = <0x00 0x8c 0x04>;
		interrupt-names = "irq_enc";
		clocks = <0x15 0x103 0x15 0x104 0x15 0x105>;
		clock-names = "aclk_vcodec\0hclk_vcodec\0clk_core";
		rockchip,normal-rates = <0x11b3dc40 0x00 0x11b3dc40>;
		resets = <0x15 0x133 0x15 0x134 0x15 0x135>;
		reset-names = "video_a\0video_h\0video_core";
		assigned-clocks = <0x15 0x103 0x15 0x105>;
		assigned-clock-rates = <0x11b3dc40 0x11b3dc40>;
		iommus = <0xda>;
		node-name = "rkvenc";
		rockchip,srv = <0xd5>;
		rockchip,taskqueue-node = <0x03>;
		rockchip,resetgroup-node = <0x03>;
		power-domains = <0x17 0x0e>;
		status = "okay";
		venc-supply = <0xdb>;
		memory-region = <0xd6>;
	};

	rkvenc-opp-table {
		compatible = "operating-points-v2";
		nvmem-cells = <0x09>;
		nvmem-cell-names = "pvtm";
		rockchip,pvtm-voltage-sel = <0x00 0x14820 0x00 0x14821 0x16378 0x01 0x16379 0x186a0 0x02>;
		rockchip,pvtm-ch = <0x00 0x05>;

		opp-297000000 {
			opp-hz = <0x00 0x11b3dc40>;
			opp-microvolt = <0xdbba0>;
			opp-microvolt-L0 = <0xdbba0>;
			opp-microvolt-L1 = <0xd59f8>;
			opp-microvolt-L2 = <0xd59f8>;
		};

		opp-400000000 {
			opp-hz = <0x00 0x17d78400>;
			opp-microvolt = <0xe7ef0>;
			opp-microvolt-L0 = <0xe7ef0>;
			opp-microvolt-L1 = <0xe1d48>;
			opp-microvolt-L2 = <0xdbba0>;
		};

		opp-600000000 {
			opp-hz = <0x00 0x23c34600>;
			opp-microvolt = <0xf4240>;
			opp-microvolt-L0 = <0xf4240>;
			opp-microvolt-L1 = <0xee098>;
			opp-microvolt-L2 = <0xe7ef0>;
		};
	};

	iommu@fdf40f00 {
		compatible = "rockchip,rk3568-iommu\0rockchip,iommu-v2";
		reg = <0x00 0xfdf40f00 0x00 0x40 0x00 0xfdf40f40 0x00 0x40>;
		interrupts = <0x00 0x8d 0x04 0x00 0x8e 0x04>;
		interrupt-names = "rkvenc_mmu0\0rkvenc_mmu1";
		clocks = <0x15 0x103 0x15 0x104>;
		clock-names = "aclk\0iface";
		rockchip,disable-mmu-reset;
		rockchip,enable-cmd-retry;
		#iommu-cells = <0x00>;
		power-domains = <0x17 0x0e>;
		status = "okay";
		phandle = <0xda>;
	};

	rkvdec@fdf80200 {
		compatible = "rockchip,rkv-decoder-rk3568\0rockchip,rkv-decoder-v2";
		reg = <0x00 0xfdf80200 0x00 0x400 0x00 0xfdf80100 0x00 0x100>;
		reg-names = "regs\0link";
		interrupts = <0x00 0x5b 0x04>;
		interrupt-names = "irq_dec";
		clocks = <0x15 0x108 0x15 0x109 0x15 0x10a 0x15 0x10b 0x15 0x10c>;
		clock-names = "aclk_vcodec\0hclk_vcodec\0clk_cabac\0clk_core\0clk_hevc_cabac";
		rockchip,normal-rates = <0x11b3dc40 0x00 0x11b3dc40 0x11b3dc40 0x23c34600>;
		rockchip,advanced-rates = <0x179a7b00 0x00 0x179a7b00 0x179a7b00 0x23c34600>;
		rockchip,default-max-load = <0x1fe000>;
		resets = <0x15 0x142 0x15 0x143 0x15 0x144 0x15 0x145 0x15 0x146>;
		assigned-clocks = <0x15 0x108 0x15 0x10b 0x15 0x10a 0x15 0x10c>;
		assigned-clock-rates = <0x17d78400 0x23c34600 0x17d78400 0x23c34600>;
		reset-names = "video_a\0video_h\0video_cabac\0video_core\0video_hevc_cabac";
		power-domains = <0x17 0x0d>;
		vdec-supply = <0xdb>;
		iommus = <0xdc>;
		rockchip,srv = <0xd5>;
		rockchip,taskqueue-node = <0x04>;
		rockchip,resetgroup-node = <0x04>;
		rockchip,sram = <0xdd>;
		rockchip,rcb-iova = <0x10000000 0x10000>;
		rockchip,rcb-min-width = <0x200>;
		rockchip,task-capacity = <0x10>;
		status = "okay";
		memory-region = <0xd6>;
	};

	rkvdec-opp-table {
		compatible = "operating-points-v2";
		nvmem-cells = <0xde 0x09>;
		nvmem-cell-names = "leakage\0pvtm";
		rockchip,leakage-voltage-sel = <0x01 0x50 0x00 0x51 0xfe 0x01>;
		rockchip,pvtm-voltage-sel = <0x00 0x14820 0x00 0x14821 0x186a0 0x01>;
		rockchip,pvtm-ch = <0x00 0x05>;

		opp-297000000 {
			opp-hz = <0x00 0x11b3dc40>;
			opp-microvolt = <0xdbba0>;
			opp-microvolt-L0 = <0xdbba0>;
			opp-microvolt-L1 = <0xd59f8>;
		};

		opp-400000000 {
			opp-hz = <0x00 0x17d78400>;
			opp-microvolt = <0xdbba0>;
			opp-microvolt-L0 = <0xdbba0>;
			opp-microvolt-L1 = <0xd59f8>;
		};

		opp-500000000 {
			opp-hz = <0x00 0x1dcd6500>;
			opp-microvolt = <0xe7ef0>;
			opp-microvolt-L0 = <0xe7ef0>;
			opp-microvolt-L1 = <0xe1d48>;
		};

		opp-600000000 {
			opp-hz = <0x00 0x23c34600>;
			opp-microvolt = <0xf4240>;
			opp-microvolt-L0 = <0xf4240>;
			opp-microvolt-L1 = <0xee098>;
		};
	};

	iommu@fdf80800 {
		compatible = "rockchip,rk3568-iommu\0rockchip,iommu-v2";
		reg = <0x00 0xfdf80800 0x00 0x40 0x00 0xfdf80840 0x00 0x40>;
		interrupts = <0x00 0x5c 0x04>;
		interrupt-names = "rkvdec_mmu";
		clocks = <0x15 0x108 0x15 0x109>;
		clock-names = "aclk\0iface";
		power-domains = <0x17 0x0d>;
		#iommu-cells = <0x00>;
		status = "okay";
		phandle = <0xdc>;
	};

	npu@fde40000 {
		compatible = "rockchip,rk3568-rknpu\0rockchip,rknpu";
		reg = <0x00 0xfde40000 0x00 0x10000>;
		interrupts = <0x00 0x97 0x04>;
		clocks = <0x02 0x02 0x15 0x23 0x15 0x28 0x15 0x29>;
		clock-names = "scmi_clk\0clk\0aclk\0hclk";
		assigned-clocks = <0x15 0x23>;
		assigned-clock-rates = <0x23c34600>;
		resets = <0x15 0x2b 0x15 0x2c>;
		reset-names = "srst_a\0srst_h";
		power-domains = <0x17 0x06>;
		operating-points-v2 = <0xdf>;
		iommus = <0xe0>;
		status = "disabled";
		rknpu-supply = <0xe1>;
	};

	npu-opp-table {
		compatible = "operating-points-v2";
		mbist-vmin = <0xc96a8 0xdbba0 0xe7ef0>;
		nvmem-cells = <0xe2 0x09 0x0a 0xe3 0x0c 0x0d>;
		nvmem-cell-names = "leakage\0pvtm\0mbist-vmin\0opp-info\0specification_serial_number\0remark_spec_serial_number";
		rockchip,supported-hw;
		rockchip,max-volt = <0xf4240>;
		rockchip,temp-hysteresis = <0x1388>;
		rockchip,low-temp = <0x00>;
		rockchip,low-temp-adjust-volt = <0x00 0x3e8 0xc350>;
		rockchip,pvtm-voltage-sel = <0x00 0x14820 0x00 0x14821 0x153d8 0x01 0x153d9 0x16378 0x02 0x16379 0x186a0 0x03>;
		rockchip,pvtm-ch = <0x00 0x05>;
		rockchip,init-freq = <0xdbba0>;
		phandle = <0xdf>;

		opp-200000000 {
			opp-supported-hw = <0xfb 0xffff>;
			opp-hz = <0x00 0xbebc200>;
			opp-microvolt = <0xcf850 0xcf850 0xf4240>;
		};

		opp-300000000 {
			opp-supported-hw = <0xfb 0xffff>;
			opp-hz = <0x00 0x11b3dc40>;
			opp-microvolt = <0xcf850 0xcf850 0xf4240>;
		};

		opp-400000000 {
			opp-supported-hw = <0xfb 0xffff>;
			opp-hz = <0x00 0x17d78400>;
			opp-microvolt = <0xcf850 0xcf850 0xf4240>;
		};

		opp-600000000 {
			opp-supported-hw = <0xfb 0xffff>;
			opp-hz = <0x00 0x23c34600>;
			opp-microvolt = <0xcf850 0xcf850 0xf4240>;
		};

		opp-700000000 {
			opp-supported-hw = <0xfb 0xffff>;
			opp-hz = <0x00 0x29b92700>;
			opp-microvolt = <0xd59f8 0xd59f8 0xf4240>;
			opp-microvolt-L0 = <0xd59f8 0xd59f8 0xf4240>;
			opp-microvolt-L1 = <0xcf850 0xcf850 0xf4240>;
			opp-microvolt-L2 = <0xcf850 0xcf850 0xf4240>;
			opp-microvolt-L3 = <0xcf850 0xcf850 0xf4240>;
		};

		opp-800000000 {
			opp-supported-hw = <0xfb 0xffff>;
			opp-hz = <0x00 0x2faf0800>;
			opp-microvolt = <0xe1d48 0xe1d48 0xf4240>;
			opp-microvolt-L0 = <0xe1d48 0xe1d48 0xf4240>;
			opp-microvolt-L1 = <0xdbba0 0xdbba0 0xf4240>;
			opp-microvolt-L2 = <0xd59f8 0xd59f8 0xf4240>;
			opp-microvolt-L3 = <0xd59f8 0xd59f8 0xf4240>;
		};

		opp-900000000 {
			opp-supported-hw = <0xf9 0xffff>;
			opp-hz = <0x00 0x35a4e900>;
			opp-microvolt = <0xee098 0xee098 0xf4240>;
			opp-microvolt-L0 = <0xee098 0xee098 0xf4240>;
			opp-microvolt-L1 = <0xe7ef0 0xe7ef0 0xf4240>;
			opp-microvolt-L2 = <0xe1d48 0xe1d48 0xf4240>;
			opp-microvolt-L3 = <0xdbba0 0xdbba0 0xf4240>;
		};

		opp-1000000000 {
			opp-supported-hw = <0xf9 0xffff>;
			opp-hz = <0x00 0x3b9aca00>;
			opp-microvolt = <0xf4240 0xf4240 0xf4240>;
			opp-microvolt-L0 = <0xf4240 0xf4240 0xf4240>;
			opp-microvolt-L1 = <0xee098 0xee098 0xf4240>;
			opp-microvolt-L2 = <0xe7ef0 0xe7ef0 0xf4240>;
			opp-microvolt-L3 = <0xe1d48 0xe1d48 0xf4240>;
			status = "disabled";
		};
	};

	bus-npu {
		compatible = "rockchip,rk3568-bus";
		rockchip,busfreq-policy = "clkfreq";
		clocks = <0x02 0x02>;
		clock-names = "bus";
		operating-points-v2 = <0xe4>;
		status = "disabled";
		bus-supply = <0xdb>;
		pvtm-supply = <0x05>;
	};

	bus-npu-opp-table {
		compatible = "operating-points-v2";
		opp-shared;
		nvmem-cells = <0x09>;
		nvmem-cell-names = "pvtm";
		rockchip,pvtm-voltage-sel = <0x00 0x14820 0x00 0x14821 0x16378 0x01 0x16379 0x186a0 0x02>;
		rockchip,pvtm-ch = <0x00 0x05>;
		phandle = <0xe4>;

		opp-700000000 {
			opp-hz = <0x00 0x29b92700>;
			opp-microvolt = <0xdbba0>;
			opp-microvolt-L0 = <0xdbba0>;
			opp-microvolt-L1 = <0xd59f8>;
			opp-microvolt-L2 = <0xd59f8>;
		};

		opp-900000000 {
			opp-hz = <0x00 0x35a4e900>;
			opp-microvolt = <0xdbba0>;
		};

		opp-1000000000 {
			opp-hz = <0x00 0x3b9aca00>;
			opp-microvolt = <0xe7ef0>;
			opp-microvolt-L0 = <0xe7ef0>;
			opp-microvolt-L1 = <0xe1d48>;
			opp-microvolt-L2 = <0xdbba0>;
		};
	};

	iommu@fde4b000 {
		compatible = "rockchip,rk3568-iommu\0rockchip,iommu-v2";
		reg = <0x00 0xfde4b000 0x00 0x40>;
		interrupts = <0x00 0x97 0x04>;
		interrupt-names = "rknpu_mmu";
		clocks = <0x15 0x28 0x15 0x29>;
		clock-names = "aclk\0iface";
		power-domains = <0x17 0x06>;
		#iommu-cells = <0x00>;
		status = "disabled";
		phandle = <0xe0>;
	};

	crypto@fe380000 {
		compatible = "rockchip,rk3568-crypto";
		reg = <0x00 0xfe380000 0x00 0x4000>;
		interrupts = <0x00 0x04 0x04>;
		clocks = <0x15 0x6a 0x15 0x6b 0x15 0x6c 0x15 0x6d>;
		clock-names = "aclk\0hclk\0sclk\0apb_pclk";
		assigned-clocks = <0x15 0x6c>;
		assigned-clock-rates = <0xbebc200>;
		resets = <0x15 0x69>;
		reset-names = "crypto-rst";
		status = "okay";
	};

	chosen {
		stdout-path = "serial2:1500000n8";
	};

	hdmi-con {
		compatible = "hdmi-connector";
		type = "a";

		port {

			endpoint {
				remote-endpoint = <0xe5>;
				phandle = <0x5e>;
			};
		};
	};

	adc-keys {
		compatible = "adc-keys";
		io-channels = <0xe6 0x00>;
		io-channel-names = "buttons";
		keyup-threshold-microvolt = <0x1b7740>;
		poll-interval = <0x64>;

		vol-up-key {
			label = "volume up";
			linux,code = <0x73>;
			press-threshold-microvolt = <0x6d6>;
		};

		vol-down-key {
			label = "volume down";
			linux,code = <0x72>;
			press-threshold-microvolt = <0x48a1c>;
		};

		menu-key {
			label = "menu";
			linux,code = <0x8b>;
			press-threshold-microvolt = <0xef420>;
		};

		back-key {
			label = "back";
			linux,code = <0x9e>;
			press-threshold-microvolt = <0x13eb9c>;
		};
	};

	dc-12v {
		compatible = "regulator-fixed";
		regulator-name = "dc_12v";
		regulator-always-on;
		regulator-boot-on;
		regulator-min-microvolt = <0xb71b00>;
		regulator-max-microvolt = <0xb71b00>;
		phandle = <0xe8>;
	};

	vcc12v-sata {
		compatible = "regulator-fixed";
		regulator-name = "vcc12v_sata";
		regulator-always-on;
		regulator-boot-on;
		regulator-min-microvolt = <0xb71b00>;
		regulator-max-microvolt = <0xb71b00>;
		enable-active-high;
		gpio = <0x63 0x01 0x00>;
		pinctrl-names = "default";
		pinctrl-0 = <0xe7>;
		vin-supply = <0xe8>;
	};

	vcc3v3-sys {
		compatible = "regulator-fixed";
		regulator-name = "vcc3v3_sys";
		regulator-always-on;
		regulator-boot-on;
		regulator-min-microvolt = <0x325aa0>;
		regulator-max-microvolt = <0x325aa0>;
		vin-supply = <0xe8>;
		phandle = <0x2c>;
	};

	nvme_en {
		compatible = "regulator-fixed";
		regulator-name = "nvme_en";
		regulator-always-on;
		regulator-boot-on;
		regulator-min-microvolt = <0x325aa0>;
		regulator-max-microvolt = <0x325aa0>;
		enable-active-high;
		gpio = <0x63 0x04 0x00>;
		pinctrl-names = "default";
		pinctrl-0 = <0xe9>;
		vin-supply = <0xe8>;
		phandle = <0xc5>;
	};

	vcc5v0-sys {
		compatible = "regulator-fixed";
		regulator-name = "vcc5v0_sys";
		regulator-always-on;
		regulator-boot-on;
		regulator-min-microvolt = <0x4c4b40>;
		regulator-max-microvolt = <0x4c4b40>;
		vin-supply = <0xe8>;
		phandle = <0x27>;
	};

	vcc5v0-host-regulator {
		compatible = "regulator-fixed";
		regulator-name = "vcc5v0_host";
		regulator-boot-on;
		regulator-always-on;
		regulator-min-microvolt = <0x4c4b40>;
		regulator-max-microvolt = <0x4c4b40>;
		vin-supply = <0x27>;
		phandle = <0xb4>;
	};

	vcc5v0-otg-regulator {
		compatible = "regulator-fixed";
		regulator-name = "vcc5v0_otg";
		regulator-boot-on;
		regulator-always-on;
		regulator-min-microvolt = <0x4c4b40>;
		regulator-max-microvolt = <0x4c4b40>;
		enable-active-high;
		gpio = <0x28 0x05 0x00>;
		vin-supply = <0x27>;
		pinctrl-names = "default";
		pinctrl-0 = <0xea>;
		phandle = <0xb5>;
	};

	vcc-phy-regulator {
		compatible = "regulator-fixed";
		regulator-name = "vcc_phy";
		regulator-always-on;
		regulator-boot-on;
		phandle = <0xcf>;
	};

	vcc2v8-sys {
		compatible = "regulator-fixed";
		regulator-name = "vcc2v8_dvp";
		regulator-always-on;
		regulator-boot-on;
		regulator-min-microvolt = <0x2ab980>;
		regulator-max-microvolt = <0x2ab980>;
		vin-supply = <0x2c>;
	};

	vcc1v8-dvp {
		compatible = "regulator-fixed";
		regulator-name = "vcc1v8_dvp";
		regulator-always-on;
		regulator-boot-on;
		regulator-min-microvolt = <0x1b7740>;
		regulator-max-microvolt = <0x1b7740>;
		vin-supply = <0x2c>;
	};

	vcc0v9-dvp {
		compatible = "regulator-fixed";
		regulator-name = "vcc0v9_dvp";
		regulator-always-on;
		regulator-boot-on;
		regulator-min-microvolt = <0xdbba0>;
		regulator-max-microvolt = <0xdbba0>;
		vin-supply = <0x2c>;
	};

	wireless-wlan {
		compatible = "wlan-platdata";
		wifi_chip_type = "rtl8723du";
		rockchip,grf = <0x25>;
		WIFI,poweren_gpio = <0x63 0x1c 0x00>;
		keep_wifi_power_on;
		status = "okay";
		pinctrl-names = "default";
		pinctrl-0 = <0xeb>;
		WIFI,host_wake_irq = <0x63 0x1c 0x00>;
	};

	wireless-bluetooth {
		compatible = "bluetooth-platdata";
		clocks = <0xec 0x01>;
		clock-names = "ext_clock";
		status = "okay";
	};

	leds {
		compatible = "gpio-leds";
		pinctrl-names = "default";
		pinctrl-0 = <0xed 0xee 0xef>;
		status = "okay";

		heartbeat {
			label = "heartbeat";
			gpios = <0x63 0x1d 0x00>;
			default-state = "on";
			linux,default-trigger = "heartbeat";
		};

		wifi_pwr {
			label = "wifi_pwr";
			gpios = <0x63 0x1c 0x00>;
			default-state = "on";
		};

		pcie_pwr {
			label = "pcie_pwr";
			gpios = <0xf0 0x14 0x00>;
			default-state = "on";
		};
	};

	rk809-sound {
		status = "okay";
		compatible = "simple-audio-card";
		simple-audio-card,format = "i2s";
		simple-audio-card,name = "rockchip,rk809-codec";
		simple-audio-card,mclk-fs = <0x100>;

		simple-audio-card,cpu {
			sound-dai = <0xf1>;
		};

		simple-audio-card,codec {
			sound-dai = <0xf2>;
		};
	};

	pwm-fan {
		compatible = "pwm-fan";
		#cooling-cells = <0x02>;
		pwms = <0xf3 0x00 0x9c40 0x00>;
		fan-supply = <0xe8>;
		cooling-levels = <0x00 0x32 0x64 0x96 0xc8 0xff>;
		phandle = <0x9b>;
	};
};
